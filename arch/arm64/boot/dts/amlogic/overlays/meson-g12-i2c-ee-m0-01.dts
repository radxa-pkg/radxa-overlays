/dts-v1/;
/plugin/;

/ {
	metadata {
		title = "Enable I2C_EE-M0 on GPIOZ_0 and GPIOZ_1";
		compatible = "radxa,zero2";
		category = "misc";
		exclusive = "i2c0", "GPIOZ_0", "GPIOZ_1";
		description = "Enable I2C_EE-M0 on GPIOZ_0 and GPIOZ_1.";
	};

	fragment@0 {
		target = <&i2c0>;
		__overlay__ {
			status = "okay";
			pinctrl-0 = <&i2c0_sck_z1_pins &i2c0_sda_z0_pins>;
			pinctrl-names = "default";
		};
	};
};