/dts-v1/;
/plugin/;

#include <dt-bindings/gpio/gpio.h>
#include <dt-bindings/gpio/meson-g12a-gpio.h>
#include <dt-bindings/interrupt-controller/irq.h>

/ {
	metadata {
		title = "Enable spidev on SPI-A";
		compatible = "radxa,zero";
		category = "misc";
		description = "Enable spidev on SPI-A.";
	};

	fragment@0 {
		target = <&spicc0>;
		__overlay__ {
			pinctrl-0 = <&spicc0_x_pins>;
			pinctrl-names = "default";
			cs-gpios = <&gpio GPIOX_10 GPIO_ACTIVE_LOW>;
			#address-cells = <1>;
			#size-cells = <0>;
			spidev@0 {
				compatible = "spidev";
				status = "okay";
				reg = <0>;
				spi-max-frequency = <10000000>;
			};
		};
	};
};
