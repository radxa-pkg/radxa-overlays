/dts-v1/;
/plugin/;

/ {
	metadata {
		title = "Enable Watchdog";
		compatible = "amlogic,g12a", "amlogic,g12b";
		category = "misc";
		exclusive = "wdt";
		description = "Enable Watchdog.";
	};
};

&watchdog {
	status = "okay";
};
