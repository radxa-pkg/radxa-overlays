/dts-v1/;
/plugin/;

#include <dt-bindings/gpio/gpio.h>
#include <dt-bindings/gpio/meson-g12a-gpio.h>

/ {
	metadata {
		title = "Enable gpio-poweroff on GPIOAO_9";
		compatible = "radxa,zero";
		category = "misc";
		exclusive = "GPIOAO_9";
		description = "Enable gpio-poweroff on GPIOAO_9,";
	};

	fragment@0 {
		target-path = "/";
		__overlay__ {
			gpio-poweroff {
				compatible = "gpio-poweroff";
				gpios = <&gpio_ao GPIOAO_9 GPIO_ACTIVE_LOW>;
				timeout-ms = <20000>;
				force;
			};
		};
	};
};
