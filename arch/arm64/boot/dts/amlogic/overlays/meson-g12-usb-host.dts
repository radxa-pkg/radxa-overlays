/dts-v1/;
/plugin/;

/ {
	metadata {
		title = "Set OTG port to Host mode";
		compatible = "radxa,zero", "radxa,zero2";
		category = "misc";
		exclusive = "usb";
		description = "Set OTG port to Host mode.\nUse this when you want to connect USB devices.";
	};

	fragment@0 {
		target = <&usb>;

		__overlay__ {
			status = "okay";
			dr_mode = "host";
		};
	};
};
