/dts-v1/;
/plugin/;

/ {
	metadata {
		title = "Enable PWM-F on GPIOH_5";
		compatible = "radxa,zero2";
		category = "misc";
		exclusive = "pwm_ef", "GPIOH_5";
		description = "Enable PWM-F on GPIOH_5.";
	};

	fragment@0 {
		target = <&pwm_ef>;
		__overlay__ {
			pinctrl-0 = <&pwm_e_pins &pwm_f_h_pins>;
			pinctrl-names = "default";
			clocks = <&xtal>;
			clock-names = "clkin2";
			status = "okay";
		};
	};
};