/dts-v1/;
/plugin/;

/ {
	metadata {
		title = "Set OTG port to Peripheral mode";
		compatible = "unknown";
		category = "misc";
		exclusive = "usb";
		description = "Set OTG port to Peripheral mode.
Use this when you want to connect to another computer.";
	};
};

&usb {
	status = "okay";
	dr_mode = "peripheral";
};
