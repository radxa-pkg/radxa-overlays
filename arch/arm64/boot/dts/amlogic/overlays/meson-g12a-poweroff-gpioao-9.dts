/dts-v1/;
/plugin/;

#include <dt-bindings/gpio/gpio.h>
#include <dt-bindings/gpio/meson-g12a-gpio.h>

/ {
	compatible = "radxa,zero", "amlogic,g12a";

	fragment@0 {
		target-path = "/";
		__overlay__ {
			gpio-poweroff {
				compatible = "gpio-poweroff";
				/* Sets poweroff pin to GPIOAO_9 as an example. Modify as needed. */
				gpios = <&gpio_ao GPIOAO_9 GPIO_ACTIVE_LOW>;
				timeout-ms = <20000>;
				force;
			};
		};
	};
};
