/dts-v1/;
/plugin/;

/ {
	metadata {
		title = "Enable PWM-D on GPIOA_4";
		compatible = "radxa,zero2";
		category = "misc";
		exclusive = "pwm_cd", "GPIOA_4";
		description = "Enable PWM-D on GPIOA_4.";
	};
};

&pwm_cd {
	pinctrl-0 = <&pwm_d_a_pins>;
	pinctrl-names = "default";
	clocks = <&xtal>;
	clock-names = "clkin1";
	status = "okay";
};
