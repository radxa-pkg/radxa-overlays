/dts-v1/;
/plugin/;

/ {
	compatible = "radxa,zero2", "amlogic,a311d", "amlogic,g12b";

	fragment@0 {
		target = <&uart_AO_B>;
		__overlay__ {
			status = "okay";
			pinctrl-0 = <&uart_ao_b_8_9_pins>;
			pinctrl-names = "default";
		};
	};
};