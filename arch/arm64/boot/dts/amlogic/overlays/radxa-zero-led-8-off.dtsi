&led_power {
	status = "disabled";
};

&gpio_ao {
    gpio-line-names =
		/* GPIOAO */
		"PIN_8", "PIN_10", "PIN_28", "PIN_27", "PIN_32", "", "", "",
		"PIN_35", "PIN_37", "", "PIN_40",
		/* GPIOE */
		"", "", "";
};
