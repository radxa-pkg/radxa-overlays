/dts-v1/;
/plugin/;

#include <dt-bindings/gpio/gpio.h>
#include <dt-bindings/gpio/meson-g12a-gpio.h>
#include <dt-bindings/interrupt-controller/irq.h>

/ {
	metadata {
		title = "Enable SPI-A on GPIOX_8 - GPIOX_11";
		compatible = "radxa,zero";
		category = "misc";
		exclusive = "spicc0", "GPIOX_8", "GPIOX_9", "GPIOX_10", "GPIOX_11";
		description = "Enable SPI-A on GPIOX_8 - GPIOX_11.";
	};

	fragment@0 {
		target = <&spicc0>;
		__overlay__ {
			pinctrl-0 = <&spicc0_x_pins>;
			pinctrl-names = "default";
			cs-gpios = <&gpio GPIOX_10 GPIO_ACTIVE_LOW>;
			#address-cells = <1>;
			#size-cells = <0>;
			status = "okay";
			spidev@0 {
				compatible = "armbian,spi-dev";
				status = "okay";
				reg = <0>;
				spi-max-frequency = <10000000>;
			};
		};
	};
};
