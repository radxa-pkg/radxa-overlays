/dts-v1/;
/plugin/;

/ {
	metadata {
		title = "Disable GPU";
		compatible = "radxa,zero", "radxa,zero2";
		category = "misc";
		exclusive = "gpu";
		description = "Disable GPU.";
	};
};

&mali {
	status = "disabled";
};
