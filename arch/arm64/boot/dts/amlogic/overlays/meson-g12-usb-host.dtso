/dts-v1/;
/plugin/;

/ {
	metadata {
		title = "Set OTG port to Host mode";
		compatible = "unknown";
		category = "misc";
		exclusive = "usb";
		description = "Set OTG port to Host mode.
Use this when you want to connect USB devices.";
	};
};

&usb {
	status = "okay";
	dr_mode = "host";
};
