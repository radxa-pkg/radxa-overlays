/dts-v1/;
/plugin/;

#include "radxa-zero-led-8-off.dtsi"

/ {
	metadata {
		title = "Enable GPIOAO_8 for hardware version 1.51 and later";
		compatible = "radxa,zero";
		category = "misc";
		exclusive = "led_power";
		description = "Enable GPIOAO_8 for hardware version 1.51 and later.
This is due to older version uses this for Power LED.";
	};
};
