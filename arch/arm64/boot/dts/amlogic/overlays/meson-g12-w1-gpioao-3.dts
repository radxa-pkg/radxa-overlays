/dts-v1/;
/plugin/;

#include <dt-bindings/gpio/gpio.h>
#include <dt-bindings/gpio/meson-g12a-gpio.h>

/ {
	metadata {
		title = "Enable 1-Wire on GPIOAO_3";
		compatible = "radxa,zero";
		category = "misc";
		exclusive = "GPIOAO_3";
		description = "Enable 1-Wire on GPIOAO_3.";
	};

	fragment@0 {
		target-path = "/";
		__overlay__ {
			w1: onewire {
				compatible = "w1-gpio";
				gpios = <&gpio_ao GPIOAO_3 GPIO_ACTIVE_HIGH>;
				status = "okay";
			};
		};
	};
};