/dts-v1/;
/plugin/;

/ {
	metadata {
		title = "Enable PWM-D on GPIOZ_2";
		compatible = "radxa,zero2";
		category = "misc";
		exclusive = "pwm_cd", "GPIOZ_2";
		description = "Enable PWM-D on GPIOZ_2.";
	};

	fragment@0 {
		target = <&pwm_cd>;
		__overlay__ {
			pinctrl-0 = <&pwm_d_z_pins>;
			pinctrl-names = "default";
			clocks = <&xtal>;
			clock-names = "clkin1";
			status = "okay";
		};
	};
};