/dts-v1/;
/plugin/;

/ {
	metadata {
		title = "Enable PWM-B on GPIOZ_0";
		compatible = "radxa,zero2";
		category = "misc";
		exclusive = "pwm_ab", "GPIOZ_0";
		description = "Enable PWM-B on GPIOZ_0.";
	};

	fragment@0 {
		target = <&pwm_ab>;
		__overlay__ {
			pinctrl-0 = <&pwm_a_e_pins &pwm_b_z_pins>;
			pinctrl-names = "default";
			clocks = <&xtal>;
			clock-names = "clkin0";
			status = "okay";
		};
	};
};