/dts-v1/;
/plugin/;

&{/} {
	vddio_c: regulator-vddio-c {
		compatible = "regulator-gpio";
		regulator-name = "VDDIO_C";
		regulator-min-microvolt = <1800000>;
		regulator-max-microvolt = <3300000>;
		regulator-always-on;

		gpios-states = <0>;
		states = <3300000 0>,
					<1800000 1>;
	};
};

&sd_emmc_b {
	sd-uhs-sdr12;
	sd-uhs-sdr25;
	sd-uhs-sdr50;
	sd-uhs-ddr50;
	sd-uhs-sdr104;
	max-frequency = <200000000>;
	vqmmc-supply = <&vddio_c>;
};
