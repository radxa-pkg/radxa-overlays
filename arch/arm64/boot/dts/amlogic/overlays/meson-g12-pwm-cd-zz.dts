/dts-v1/;
/plugin/;

/ {
	metadata {
		title = "Enable PWM-C on GPIOZ_1 and PWM-D on GPIOZ_2";
		compatible = "radxa,zero2";
		category = "misc";
		exclusive = "pwm_cd", "GPIOZ_1", "GPIOZ_2";
		description = "Enable PWM-C on GPIOZ_1 and PWM-D on GPIOZ_2.\nIndividual overlays of PWM-C and PWM-D cannot be applied at the same time.";
	};

	fragment@0 {
		target = <&pwm_cd>;
		__overlay__ {
			pinctrl-0 = <&pwm_c_z_pins &pwm_d_z_pins>;
			pinctrl-names = "default";
			clocks = <&xtal>;
			clock-names = "clkin1";
			status = "okay";
		};
	};
};