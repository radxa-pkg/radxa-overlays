/dts-v1/;
/plugin/;

/ {
	metadata {
		title = "Enable I2C_EE-M3 on GPIOA_14 and GPIOA_15";
		compatible = "radxa,zero", "radxa,zero2";
		category = "misc";
		exclusive = "i2c3", "GPIOA_14", "GPIOA_15";
		description = "Enable I2C_EE-M3 on GPIOA_14 and GPIOA_15.";
	};

	fragment@0 {
		target = <&i2c3>;
		__overlay__ {
			status = "okay";
			pinctrl-0 = <&i2c3_sck_a_pins &i2c3_sda_a_pins>;
			pinctrl-names = "default";
		};
	};
};
