/dts-v1/;
/plugin/;

#include "radxa-zero-led-10-off.dtsi"
#include "meson-g12-uart-ao-b-89.dtsi"

/ {
	metadata {
		title = "Enable UART_AO-B on GPIOAO_8 and GPIOAO_9";
		compatible = "radxa,zero";
		category = "misc";
		exclusive = "uart_AO_B", "GPIOAO_8", "GPIOAO_9";
		description = "Enable UART_AO-B on GPIOAO_8 and GPIOAO_9.";
	};
};
