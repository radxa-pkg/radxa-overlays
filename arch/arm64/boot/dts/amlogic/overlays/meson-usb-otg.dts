/dts-v1/;
/plugin/;

/ {
	metadata {
		title = "Set OTG port to OTG mode";
		compatible = "radxa,zero", "radxa,zero2";
		category = "misc";
		description = "Set OTG port to OTG mode.\nThis is the default mode.";
	};

	fragment@0 {
		target = <&usb>;

		__overlay__ {
			status = "okay";
			dr_mode = "otg";
		};
	};
};
