// SPDX-License-Identifier: BSD-3-Clause
/*
 * Copyright (c) 2025 Radxa Computer (Shenzhen) Co., Ltd.
 */

/dts-v1/;
/plugin/;

/ {
	metadata {
		title = "Set OTG port to Peripheral mode";
		compatible = "radxa,dragon-q6a", "radxa,cm-q64-rpi-cm5-io";
		category = "misc";
		exclusive = "usb_1";
		description = "Set OTG port to Peripheral mode.
Use this when you want to connect to another computer
on Radxa Dragon Q6A or
Radxa CM-Q64 Raspberry Pi Compute Module 5 IO Board.";
	};
};

&usb_1 {
	dr_mode = "peripheral";
};
