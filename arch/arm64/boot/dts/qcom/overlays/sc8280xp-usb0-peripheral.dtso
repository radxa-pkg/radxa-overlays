// SPDX-License-Identifier: BSD-3-Clause
/*
 * Copyright (c) 2026 Radxa Computer (Shenzhen) Co., Ltd.
 */

/dts-v1/;
/plugin/;

/ {
	metadata {
		title = "Set USB 0 to Peripheral mode";
		compatible = "qcom,sc8280xp";
		category = "misc";
		exclusive = "usb_0_dwc3";
		description = "Set USB 0 to Peripheral mode.
Use this when you want to connect to another computer.
It will be shown as *@a600000.usb in rsetup.
It is also the default EDL port.
";
	};
};

&usb_0_dwc3 {
	dr_mode = "peripheral";
};
