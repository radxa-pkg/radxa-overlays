// SPDX-License-Identifier: BSD-3-Clause
/*
 * Copyright (c) 2025 Radxa Computer (Shenzhen) Co., Ltd.
 */

/dts-v1/;
/plugin/;

/ {
	metadata {
		title = "Enable KVM virtualization support";
		compatible = "radxa,dragon-q6a";
		category = "misc";
		exclusive = "gpu_zap_shader";
		description = "Enable KVM virtualization support.
This will break ADSP (audio), CDSP (NPU), and Venus (video codec)";
	};
};

&{/chosen} {
	radxa,enable-kvm = <1>;
};

/* We can't and don't need to use zap shader in EL2 as linux can zap the gpu on it's own. */
&gpu_zap_shader {
	status = "disabled";
};
