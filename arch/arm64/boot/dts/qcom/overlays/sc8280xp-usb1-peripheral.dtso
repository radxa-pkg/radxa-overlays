// SPDX-License-Identifier: BSD-3-Clause
/*
 * Copyright (c) 2026 Radxa Computer (Shenzhen) Co., Ltd.
 */

/dts-v1/;
/plugin/;

/ {
	metadata {
		title = "Set USB 1 to Peripheral mode";
		compatible = "qcom,sc8280xp";
		category = "misc";
		exclusive = "usb_1_dwc3";
		description = "Set USB 1 to Peripheral mode.
Use this when you want to connect to another computer.
It will be shown as *@a800000.usb in rsetup.
It is usually the 2nd Type-C port that does not support EDL.
";
	};
};

&usb_1_dwc3 {
	dr_mode = "peripheral";
};
