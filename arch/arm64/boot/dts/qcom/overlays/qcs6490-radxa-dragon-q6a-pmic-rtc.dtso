// SPDX-License-Identifier: BSD-3-Clause
/*
 * Copyright (c) 2026 Radxa Computer (Shenzhen) Co., Ltd.
 */

/dts-v1/;
/plugin/;

/ {
	metadata {
		title = "Enable PMIC RTC";
		compatible = "radxa,dragon-q6a";
		category = "misc";
		exclusive = "pmk8350_rtc";
		description = "Enable PMIC RTC.
PMIC RTC is not backed by the battery, and is disabled
so the battery backed one can be used by default.
Only enable this if you need to use RTC wake up.";
	};
};

&pmk8350_rtc {
	status = "okay";
};
