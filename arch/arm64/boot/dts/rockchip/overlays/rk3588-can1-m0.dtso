/dts-v1/;
/plugin/;

#include <dt-bindings/clock/rk3588-cru.h>

/ {
	metadata {
		title = "Enable CAN1-M0";
		compatible = "radxa,rock-5b", "radxa,rock-5b-plus";
		category = "misc";
		exclusive = "GPIO3_B5", "GPIO3_B6";
		description = "Enable CAN1-M0.
On Radxa ROCK 5B this is RX pin 12 & TX pin 35.";
	};
};

&can1 {
	status = "okay";
	compatible = "rockchip,can-2.0";
	assigned-clocks = <&cru CLK_CAN0>;
	assigned-clock-rates = <200000000>;
	pinctrl-names = "default";
	pinctrl-0 = <&can1m0_pins>;
};
