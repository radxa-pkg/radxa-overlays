/dts-v1/;
/plugin/;

/ {
	metadata {
		title = "Enable PWM2-M0";
		compatible = "radxa,rock-3a", "radxa,rock-3b";
		category = "misc";
		exclusive = "GPIO0_C1";
		description = "Enable PWM2-M0.\nOn Radxa ROCK 3A <= v1.2 this is pin 17.\nOn Radxa ROCK 3A >= v1.3 this is pin 22.\nOn Radxa ROCK 3B this is pin 22.";
	};

	fragment@0 {
		target = <&pwm2>;

		__overlay__ {
			status = "okay";
			pinctrl-names = "active";
			pinctrl-0 = <&pwm2m0_pins>;
		};
	};
};
