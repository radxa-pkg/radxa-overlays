/dts-v1/;
/plugin/;

/ {
	metadata {
		title = "Enable PWM13-M0";
		compatible = "radxa,rock-5b", "radxa,rock-5b-plus", "radxa,rock-5t";
		category = "misc";
		exclusive = "GPIO3_B6";
		description = "Enable PWM13-M0.
On Radxa ROCK 5B this is pin 35.
On Radxa ROCK 5B+ this is pin 35.
On Radxa ROCK 5T this is pin 35.";
	};
};

&pwm13 {
	status = "okay";
	pinctrl-0 = <&pwm13m0_pins>;
};
