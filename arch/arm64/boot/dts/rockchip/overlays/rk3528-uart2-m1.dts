/dts-v1/;
/plugin/;

/ {
	metadata {
		title = "Enable UART2-M1";
		compatible = "radxa,rock-2a";
		category = "misc";
		exclusive = "GPIO1_B0", "GPIO1_B1";
		description = "Enable UART2-M1.
On Radxa ROCK 2A this is RX pin 31 & TX pin 33.";
	};
};

&uart2 {
	status = "okay";
	pinctrl-names = "default";
	pinctrl-0 = <&uart2m1_xfer>;
};
