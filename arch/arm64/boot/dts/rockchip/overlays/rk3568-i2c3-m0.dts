/dts-v1/;
/plugin/;

/ {
	metadata {
		title = "Enable I2C3-M0";
		compatible = "radxa,rock-3a", "radxa,rock-3b", "radxa,rock-3c", "radxa,zero3", "radxa,e25";
		category = "misc";
		exclusive = "GPIO1_A0", "GPIO1_A1";
		description = "Enable I2C3-M0.\nOn Radxa ROCK 3A <= 1.2 this is SDA pin 3 and SCL pin 5.\nOn Radxa ROCK 3A >= 1.3 this is SDA pin 3 and SCL pin 5.\nOn Radxa ROCK 3B this is SDA pin 3 and SCL pin 5.\nOn Radxa ROCK 3C this is SDA pin 3 and SCL pin 5.\nOn Radxa ZERO 3 this is SDA pin 3 and SCL pin 5.\nOn Radxa E25 this is SDA pin3 and SCL pin 5.";
	};

	fragment@0 {
		target = <&i2c3>;

		__overlay__ {
			status = "okay";
			pinctrl-names = "default";
			pinctrl-0 = <&i2c3m0_xfer>;
		};
	};
};
