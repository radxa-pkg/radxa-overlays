/dts-v1/;
/plugin/;

/ {
	metadata {
		title = "Enable UART1-M1 with Hardware Flow Control";
		compatible = "unknown";
		category = "misc";
		description = "Enable UART1-M1 with hardware flow control.";
	};

	fragment@0 {
		target = <&uart1>;

		__overlay__ {
			status = "okay";
			pinctrl-names = "default";
			pinctrl-0 = <&uart1m1_xfer &uart1m1_ctsn &uart1m1_rtsn>;
		};
	};
};
