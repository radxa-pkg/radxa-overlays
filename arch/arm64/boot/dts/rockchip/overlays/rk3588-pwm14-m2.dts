/dts-v1/;
/plugin/;

/ {
	metadata {
		title = "Enable PWM14-M2";
		compatible = "radxa,rock-5a", "radxa,rock-5c", "radxa,rock-5d", "radxa,cm5-rpi-cm4-io";
		category = "misc";
		exclusive = "GPIO1_D6";
		description = "Enable PWM14-M2.
On Radxa ROCK 5A this is pin 5.
On Radxa ROCK 5C this is pin 5.
On Radxa ROCK 5D this is pin 5.
On Radxa CM5 RPI CM4 IO this is pin 28.
";
	};
};

&pwm14 {
	status = "okay";
	pinctrl-0 = <&pwm14m2_pins>;
};
