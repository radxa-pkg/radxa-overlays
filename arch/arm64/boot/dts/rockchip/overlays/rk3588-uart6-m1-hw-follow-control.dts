/dts-v1/;
/plugin/;

/ {
	metadata {
		title = "Enable UART6-M1 hardware follow control";
		compatible = "radxa,rock-5a";
		category = "misc";
        exclusive = "GPIO1_A1", "GPIO1_A0", "GPIO1_A2", "GPIO1_A3";
		description = "Enable UART6-M1 hardware follow control.\nOn Radxa ROCK 5A Hardware X1.1 this is CTSN pin 13 and RTSN pin 11 and TX pin 5 and RX pin 3\nOn Radxa ROCK 5A Hardware X1.2 this is CTSN pin 24 and RTSN pin 23 and TX pin 19 and RX pin 21";
	};

	fragment@0 {
		target = <&uart6>;

		__overlay__ {
			status = "okay";
			pinctrl-0 = <&uart6m1_xfer &uart6m1_ctsn &uart6m1_rtsn>;
		};
	};
};
