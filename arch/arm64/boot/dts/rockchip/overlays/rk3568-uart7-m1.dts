/dts-v1/;
/plugin/;

/ {
	metadata {
		title = "Enable UART7-M1";
		compatible = "unknown";
		category = "misc";
		description = "Enable UART7-M1.";
	};

	fragment@0 {
		target = <&uart7>;

		__overlay__ {
			status = "okay";
			pinctrl-names = "default";
			pinctrl-0 = <&uart7m1_xfer>;
		};
	};
};
