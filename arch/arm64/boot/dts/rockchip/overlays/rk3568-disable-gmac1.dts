/dts-v1/;
/plugin/;

/ {
	metadata {
		title = "Disable Ethernet";
		compatible = "radxa,rock-3c";
		category = "misc";
		description = "Disable Ethernet.";
	};

	fragment@0 {
		target = <&gmac1>;

		__overlay__ {
			status = "disabled";
		};
	};
};
