/dts-v1/;
/plugin/;

/ {
	metadata {
		title = "Enable PWM0-M0";
		compatible = "unknown";
		category = "misc";
		description = "Enable PWM0-M0.";
	};

	fragment@0 {
		target = <&pwm0>;

		__overlay__ {
			status = "okay";
			pinctrl-names = "active";
			pinctrl-0 = <&pwm0m0_pins>;
		};
	};
};
