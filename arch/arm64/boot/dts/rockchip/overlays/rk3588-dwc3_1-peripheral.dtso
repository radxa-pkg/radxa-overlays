/dts-v1/;
/plugin/;

/ {
	metadata {
		title = "Set OTG port 1 to Peripheral mode";
		compatible = "radxa,rock-5b-plus";
		category = "misc";
		exclusive = "usbdrd_dwc3_1-dr_mode";
		description = "Set OTG port 1 to Peripheral mode.
Use this when you want to connect to another computer.";
	};
};

&usbdrd_dwc3_1 {
	status = "okay";
	dr_mode = "peripheral";
};
