/dts-v1/;
/plugin/;

#include <dt-bindings/pinctrl/rockchip.h>

/ {
	metadata {
		title = "Enable I2C8-M4";
		compatible = "radxa,rock-5b", "radxa,rock-5b-plus", "radxa,rock-5t";
		category = "misc";
		exclusive = "GPIO3_C3", "GPIO3_C2";
		description = "Enable I2C8-M4.
On Radxa ROCK 5B this is SDA pin 7 and SCL pin 32.
On Radxa ROCK 5B+ this is SDA pin 7 and SCL pin 32.
On Radxa ROCK 5T this is SDA pin 7 and SCL pin 32.";
	};
};

&i2c8 {
	status = "okay";
	pinctrl-0 = <&i2c8m4_xfer>;
};

&i2c8m4_xfer {
	rockchip,pins =
		<3 RK_PC2 9 &pcfg_pull_up>,
		<3 RK_PC3 9 &pcfg_pull_up>;
};
