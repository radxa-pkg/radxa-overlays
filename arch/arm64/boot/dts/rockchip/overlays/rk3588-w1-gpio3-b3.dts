/dts-v1/;
/plugin/;

#include <dt-bindings/gpio/gpio.h>
#include <dt-bindings/pinctrl/rockchip.h>

/ {
	metadata {
		title = "Enable 1-Wire on GPIO3_B3";
		compatible = "radxa,rock-5b", "radxa,rock-5b-plus", "radxa,rock-5t";
		category = "misc";
		exclusive = "GPIO3_B3";
		description = "Enable 1-Wire on GPIO3_B3.
On Radxa ROCK 5B this is pin 40.
On Radxa ROCK 5B+ this is pin 40.
On Radxa ROCK 5T this is pin 40.";
	};
};

&{/} {
	w1: onewire {
		compatible = "w1-gpio";
		gpios = <&gpio3 RK_PB3 GPIO_ACTIVE_HIGH>;
		status = "okay";
	};
};
