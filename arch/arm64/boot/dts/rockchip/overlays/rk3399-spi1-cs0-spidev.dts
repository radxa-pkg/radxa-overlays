/dts-v1/;
/plugin/;

/{
        metadata {
                title = "Enable spidev on SPI1 CS0";
                compatible = "rockchip,rk3399";
                category = "misc";
                description = "Enable SPI1";
        };

        fragment@0 {
                target = <&spi1>;

                __overlay__ {
                        status = "okay";
                        pinctrl-names = "default";
                        pinctrl-0 = <&spi1_clk &spi1_cs0 &spi1_rx &spi1_tx>;
                        #address-cells = <1>;
                        #size-cells = <0>;

                        spidev@0 {
                                compatible = "rockchip,spidev";
                                reg = <0>;
                                spi-max-frequency = <50000000>;
                        };
                };
        };
};
