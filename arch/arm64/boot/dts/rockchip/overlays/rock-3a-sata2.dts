// ROCK 3A Pcie M.2 to sata
/dts-v1/;
/plugin/;

/ {
	metadata {
		title = "Enable SATA2";
		compatible = "radxa,rock-3a-pcie";
		category = "misc";
		description = "Enable SATA2.
When SATA2 is enabled, PCIe cannot be enabled on the same port.";
	};
};

&pcie2x1 {
	status = "disabled";
};

&sata2 {
	status = "okay";
};
