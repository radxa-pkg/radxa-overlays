/dts-v1/;
/plugin/;

#include <dt-bindings/gpio/gpio.h>
#include <dt-bindings/pinctrl/rockchip.h>

/ {
	metadata {
		title = "Enable 1-Wire on GPIO3_A5";
		compatible = "radxa,rock-3c";
		category = "misc";
		exclusive = "GPIO3_A5";
		description = "Enable 1-Wire on GPIO3_A5.\nOn ROCK 3C this is pin 40.";
	};

	fragment@0 {
		target-path = "/";

		__overlay__ {
			w1: onewire {
				compatible = "w1-gpio";
				gpios = <&gpio3 RK_PA5 GPIO_ACTIVE_HIGH>;
				status = "okay";
			};
		};
	};
};
