/dts-v1/;
/plugin/;

/ {
	metadata {
		title = "Enable spidev on SPI1-M2 over CS0";
		compatible = "radxa,nx5-io";
		category = "misc";
		exclusive =  "GPIO1_D0", "GPIO1_D1", "GPIO1_D2", "GPIO1_D3";
		description = "Enable spidev on SPI1-M2 over CS0.";
	};
};

&spi1 {
	status = "okay";
	#address-cells = <1>;
	#size-cells = <0>;
	pinctrl-names = "default";
	pinctrl-0 = <&spi1m2_cs0 &spi1m2_pins>;
	max-freq = <50000000>;

	spidev@0 {
		compatible = "rockchip,spidev";
		status = "okay";
		reg = <0>;
		spi-max-frequency = <50000000>;
	};
};
