/dts-v1/;
/plugin/;

/ {
	metadata {
		title = "Enable PWM14-M0";
		compatible = "radxa,rock-5b", "radxa,rock-5b-plus", "radxa,rock-5t";
		category = "misc";
		exclusive = "GPIO3_C2";
		description = "Enable PWM14-M0.
On Radxa ROCK 5B this is pin 32
On Radxa ROCK 5B+ this is pin 32.
On Radxa ROCK 5T this is pin 32.";
	};
};

&pwm14 {
	status = "okay";
	pinctrl-0 = <&pwm14m0_pins>;
};
