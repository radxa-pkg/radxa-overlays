/dts-v1/;
/plugin/;

/{
        metadata {
                title = "Enable SPI2";
                compatible = "rockchip,rk3399";
                category = "misc";
                description = "Enable SPI2";
        };

        fragment@0 {
                target = <&spi2>;

                __overlay__ {
                        status = "okay";
                        pinctrl-names = "default";
                        pinctrl-0 = <&spi2_clk &spi2_cs0 &spi2_rx &spi2_tx>;
                        #address-cells = <1>;
                        #size-cells = <0>;

                        spidev@0 {
                                compatible = "rockchip,spidev";
                                reg = <0>;
                                spi-max-frequency = <50000000>;
                        };
                };
        };
};
