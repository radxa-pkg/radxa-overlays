/dts-v1/;
/plugin/;

/ {
	metadata {
		title = "Enable PWM6";
		compatible = "radxa,rock-s0";
		category = "misc";
		exclusive = "GPIO0_C2", "uart3";
		description = "Enable PWM6.
On ROCK S0 this is pin 33.";
	};
};

&pwm6 {
	status = "okay";
	pinctrl-names = "default";
	pinctrl-0 = <&pwm6_pin>;
};

&uart3 {
	status = "disabled";
};
