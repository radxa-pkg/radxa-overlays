/dts-v1/;
/plugin/;

/ {
	metadata {
		title = "Enable PWM6";
		compatible = "radxa,radxa-cm3-io", "radxa,radxa-cm3-sodimm-io", "radxa,e23";
		category = "misc";
		exclusive = "GPIO0_C5";
		description = "Enable PWM6.\nOn Radxa CM3 IO this is on pin 31.\nOn Radxa CM3 SODIMM IO this is on pin 21.\nOn Radxa E23 this is pin 7.";
	};

	fragment@0 {
		target = <&pwm6>;

		__overlay__ {
			status = "okay";
			pinctrl-names = "active";
			pinctrl-0 = <&pwm6_pins>;
		};
	};
};
