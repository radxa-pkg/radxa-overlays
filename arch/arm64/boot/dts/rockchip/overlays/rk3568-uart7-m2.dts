/dts-v1/;
/plugin/;

/ {
	metadata {
		title = "Enable UART7-M2";
		compatible = "radxa,radxa-cm3-sodimm-io";
		category = "misc";
		exclusive = "GPIO4_A2", "GPIO4_A3";
		description = "Enable UART7-M2.\nOn Radxa CM3 SODIMM IO this TX pin 36 and RX pin 11.";
	};

	fragment@0 {
		target = <&uart7>;

		__overlay__ {
			status = "okay";
			pinctrl-0 = <&uart7m2_xfer>;
		};
	};
};
