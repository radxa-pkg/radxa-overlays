/dts-v1/;
/plugin/;

/ {
	metadata {
		title = "Set OTG port 0 to Peripheral mode";
		compatible = "radxa,rock-5a", "radxa,rock-5b", "radxa,rock-5c", "radxa,rock-5d", "radxa,cm5-io", "radxa,nx5-io", "radxa,e52c";
		category = "misc";
		exclusive = "usbdrd_dwc3-dr_mode";
		description = "Set OTG port 0 to Peripheral mode.
Use this when you want to connect to another computer.";
	};
};

&usbdrd_dwc3_0 {
	status = "okay";
	dr_mode = "peripheral";
};
