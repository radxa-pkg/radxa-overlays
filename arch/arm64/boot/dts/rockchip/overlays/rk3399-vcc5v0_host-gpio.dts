/dts-v1/;
/plugin/;

/ {
	metadata {
		title = "Free vcc5v0_host regulator control GPIO";
		compatible = "radxa,rock-4se";
		category = "misc";
		exclusive = "vcc5v0_host", "GPIO4_D1";
		description = "Free vcc5v0_host regulator control GPIO.
On ROCK 4SE, this regulator controls the power to non-OTG ports.
You can use `gpioset -m wait 4 25=<0/1>` to control the port power.";
	};
};

&vcc5v0_host {
	gpio = <0>;
};
