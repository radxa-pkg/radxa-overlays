/dts-v1/;
/plugin/;

#include <dt-bindings/clock/rockchip,rk3576-cru.h>

/ {
	metadata {
		title = "Enable CAN1-M1";
		compatible = "radxa,rock-4d";
		category = "misc";
		exclusive = "GPIO4_C6", "GPIO4_C7", "can1";
		description = "Enable CAN1-M1.
On Radxa ROCK 4D this is TX pin 28 and RX pin 27.
";
	};
};

&can1 {
	assigned-clocks = <&cru CLK_CAN1>;
	assigned-clock-rates = <200000000>;
	pinctrl-names = "default";
	pinctrl-0 = <&can1m1_pins>;
	status = "okay";
};
