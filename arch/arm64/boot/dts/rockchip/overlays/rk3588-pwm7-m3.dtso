/dts-v1/;
/plugin/;

/ {
	metadata {
		title = "Enable PWM7-M3";
		compatible = "radxa,rock-5b", "radxa,rock-5b-plus", "radxa,rock-5t";
		category = "misc";
		exclusive = "GPIO4_C6";
		description = "Enable PWM7-M3.
On Radxa ROCK 5B this is pin 27.
On Radxa ROCK 5B+ this is pin 27.
On Radxa ROCK 5T this is pin 27.";
	};
};

&pwm7 {
	status = "okay";
	pinctrl-0 = <&pwm7m3_pins>;
};
