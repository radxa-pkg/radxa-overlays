/dts-v1/;
/plugin/;

/ {
	metadata {
		title = "Enable I2C0-M2";
		compatible = "unknown";
		category = "misc";
		exclusive = "GPIO0_D1", "GPIO0_D2";
		description = "Enable I2C0-M2.
On Radxa NX5 IO this is SDA pin 27 & SCL pin 28.";
	};
};

&i2c0 {
	status = "okay";
	pinctrl-0 = <&i2c0m2_xfer>;
};
