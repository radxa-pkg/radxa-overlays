/dts-v1/;
/plugin/;

/ {
	metadata {
		title = "Enable PWM1-CH3-M1";
		compatible = "radxa,cm4-rpi-cm4-io", "radxa,cm4-io", "radxa,rock-4d";
		category = "misc";
		exclusive = "GPIO1_D2", "pwm1_6ch_3";
		description = "Enable PWM1-CH3-M1.
On Radxa CM4 RPI CM4 IO this is pin 35.
On Radxa CM4 IO this is pin 35.
On Radxa ROCK 4D this is pin 35.
";
	};
};

&pwm1_6ch_3 {
	status = "okay";
	pinctrl-0 = <&pwm1m1_ch3>;
};
