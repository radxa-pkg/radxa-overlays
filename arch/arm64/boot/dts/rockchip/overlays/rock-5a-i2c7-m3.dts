#include "rk3588-i2c7-m3.dts"

/ {
	metadata {
		title = "Enable I2C7-M3 and Disable onboard Audio Jack";
		compatible = "radxa,rock-5a", "radxa,rock-5c", "radxa,rock-5d";
		description = "Enable I2C7-M3 and Disable onboard Audio Jack.
Onboard audio jack has to be disabled, as the codec is connected to I2C7 on different pins.
Once I2C signal is routed to 40-pin header, the codec is disconnected, thus unusable.
On Radxa ROCK 5A this is SDA pin 11 & SCL pin 13.
On Radxa ROCK 5C this is SDA pin 11 & SCL pin 13.
On Radxa ROCK 5D this is SDA pin 11 & SCL pin 13.
";
	};
};

&es8316 {
	status = "disabled";
};
