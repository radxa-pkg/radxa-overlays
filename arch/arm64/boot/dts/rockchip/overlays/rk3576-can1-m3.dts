/dts-v1/;
/plugin/;

#include <dt-bindings/clock/rockchip,rk3576-cru.h>

/ {
	metadata {
		title = "Enable CAN1-M3";
		compatible = "radxa,cm4-rpi-cm4-io";
		category = "misc";
		exclusive = "GPIO3_A2", "GPIO3_A3", "can1";
		description = "Enable CAN1-M3.
On Radxa CM4-RPI-CM4-IO this is TX pin 29 and Rx pin 37.";
	};
};

&can1 {
	assigned-clocks = <&cru CLK_CAN1>;
	assigned-clock-rates = <200000000>;
	pinctrl-names = "default";
	pinctrl-0 = <&can1m3_pins>;
	status = "okay";
};
