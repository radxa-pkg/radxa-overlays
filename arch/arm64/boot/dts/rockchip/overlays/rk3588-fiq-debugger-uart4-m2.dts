/dts-v1/;
/plugin/;

/ {
	metadata {
		title = "Enable FIQ Debugger on UART4-M2";
		compatible = "radxa,rock-5b";
		category = "misc";
		exclusive = "GPIO1_B2", "GPIO1_B3";
		description = "Enable FIQ Debugger on UART7-M1.\nOn Radxa ROCK 5B this is TX pin 23 , RX pin 19.";
	};

	fragment@0 {
		target = <&fiq_debugger>;

		__overlay__ {
			status = "okay";
			rockchip,serial-id = <4>;
			pinctrl-names = "default";
			pinctrl-0 = <&uart4m2_xfer>;
		};
	};

	fragment@1 {
		target = <&uart4>;

		__overlay__ {
			status = "disabled";
		};
	};
};
