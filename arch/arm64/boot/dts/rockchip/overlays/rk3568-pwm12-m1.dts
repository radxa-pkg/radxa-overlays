/dts-v1/;
/plugin/;

/ {
	metadata {
		title = "Enable PWM12-M1";
		compatible = "radxa,rock-3c", "radxa,rock-3b";
		category = "misc";
		exclusive = "GPIO4_C5", "pwm12";
		description = "Enable PWM12-M1.\nOn Radxa ROCK 3B this is pin 21.\nOn Radxa ROCK 3C this is pin 21.";
	};

	fragment@0 {
		target = <&pwm12>;

		__overlay__ {
			status = "okay";
			pinctrl-names = "active";
			pinctrl-0 = <&pwm12m1_pins>;
		};
	};
};
