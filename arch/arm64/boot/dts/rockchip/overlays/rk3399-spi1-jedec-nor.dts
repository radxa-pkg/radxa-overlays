/dts-v1/;
/plugin/;

/ {
	metadata {
		title = "Enable JEDEC SPI NOR on SPI1";
		compatible = "rockchip,rk3399";
		category = "misc";
		exclusive = "GPIO1_B0", "GPIO1_A7", "GPIO1_B1", "GPIO1_B2";
		description = "Enable JEDEC SPI NOR on SPI1 on pin 19, 21, 23 & 24.
This also enables the onboard SPI flash if you have one.";
	};
};

&spi1 {
	status = "okay";
	pinctrl-names = "default";
	pinctrl-0 = <&spi1_clk &spi1_cs0 &spi1_rx &spi1_tx>;
	#address-cells = <1>;
	#size-cells = <0>;

	spiflash@0 {
		compatible = "jedec,spi-nor";
		reg = <0>;
		spi-max-frequency = <8000000>;
		status = "okay";
	};
};
