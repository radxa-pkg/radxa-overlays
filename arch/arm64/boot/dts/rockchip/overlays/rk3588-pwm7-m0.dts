/dts-v1/;
/plugin/;

/ {
	metadata {
		title = "Enable PWM7-M0";
		compatible = "radxa,rock-5a", "radxa,cm5-io", "radxa,cm5-rpi-cm4-io";
		category = "misc";
		exclusive = "GPIO0_D0";
		description = "Enable PWM7-M0.\nOn Radxa ROCK 5A this is pin 28.\nOn Radxa CM5 IO this is pin 29.\nOn Radxa CM5 RPI CM4 IO this is pin 3.\n";
	};

	fragment@0 {
		target = <&pwm7>;

		__overlay__ {
			status = "okay";
			pinctrl-0 = <&pwm7m0_pins>;
		};
	};
};
