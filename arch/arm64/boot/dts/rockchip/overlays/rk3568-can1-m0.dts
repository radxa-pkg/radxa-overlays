/dts-v1/;
/plugin/;

/ {
	metadata {
		title = "Enable CAN1-M0";
		compatible = "unknown";
		category = "misc";
		description = "Enable CAN1-M0.\nOn ROCK 3C this is RX pin 3 & TX pin 5.";
	};

	fragment@0 {
		target = <&can1>;

		__overlay__ {
			status = "okay";
			assigned-clocks = <&cru 323>;
			assigned-clock-rates = <100000000>;
			pinctrl-names = "default";
			pinctrl-0 = <&can1m0_pins>;
		};
	};
};
