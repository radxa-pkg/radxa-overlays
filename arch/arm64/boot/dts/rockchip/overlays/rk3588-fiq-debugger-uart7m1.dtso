/dts-v1/;
/plugin/;

/ {
	metadata {
		title = "Enable FIQ Debugger on UART7-M1";
		compatible = "radxa,rock-5b", "radxa,rock-5b-plus", "radxa,rock-5t";
		category = "misc";
		exclusive = "GPIO3_C1", "GPIO3_C0";
		description = "Enable FIQ Debugger on UART7-M1.
On Radxa ROCK 5B this is TX pin 15 & RX pin 11.
On Radxa ROCK 5B+ this is TX pin 15 & RX pin 11.
On Radxa ROCK 5T this is TX pin 15 & RX pin 11.";
	};
};

&fiq_debugger {
	status = "okay";
	rockchip,serial-id = <7>;
	pinctrl-names = "default";
	pinctrl-0 = <&uart7m1_xfer>;
};

&uart7 {
	status = "disabled";
};
