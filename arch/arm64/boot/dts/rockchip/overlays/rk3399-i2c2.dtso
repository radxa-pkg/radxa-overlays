/dts-v1/;
/plugin/;

/ {
	metadata {
		title = "Enable I2C2";
		compatible = "rockchip,rk3399";
		category = "misc";
		exclusive = "GPIO2_A0", "GPIO2_A1";
		description = "Enable I2C2 on pin 27 & 28.";
	};
};

&i2c2 {
	status = "okay";
	pinctrl-names = "default";
	pinctrl-0 = <&i2c2_xfer>;
};
