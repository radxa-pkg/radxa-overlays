/dts-v1/;
/plugin/;

/ {
	metadata {
		title ="Enable EMMC";
		compatible = "radxa,rock-5-itx";
		category = "display";
		exclusive = "sdhci";
		description = "Enable EMMC.";
	};
};

&sdhci {
	status = "okay";
};
