/dts-v1/;
/plugin/;

/ {
	metadata {
		title = "Enable UART4-M1";
		compatible = "radxa,cm4-rpi-cm4-io";
		category = "misc";
		exclusive = "GPIO1_C4", "GPIO1_C5", "uart4";
		description = "Enable UART4-M1.
On Radxa CM4 RPI CM4 IO this is TX pin 13 & RX pin 15.
";
	};
};

&uart4 {
	status = "okay";
	pinctrl-0 = <&uart4m1_xfer>;
};
