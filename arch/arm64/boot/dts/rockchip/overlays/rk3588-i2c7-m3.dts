/dts-v1/;
/plugin/;

/ {
	metadata {
		title = "Enable I2C7-M3";
		compatible = "radxa,rock-5t-industrial";
		category = "misc";
		exclusive = "GPIO4_B2", "GPIO4_B3";
		description = "Enable I2C7-M3.
On Radxa ROCK 5T Industrial this is TX pin 7 & RX pin 32.";
	};
};

&i2c7 {
	status = "okay";
	pinctrl-0 = <&i2c7m3_xfer>;
};
