/dts-v1/;
/plugin/;

/ {
	metadata {
		title = "Enable PWM8-M2";
		compatible = "radxa,cm5-rpi-cm4-io";
		category = "misc";
		exclusive = "GPIO3_D0";
		description = "Enable PWM8-M2.
On Radxa CM5 RPI CM4 IO this is pin 37.";
	};
};

&pwm8 {
	status = "okay";
	pinctrl-0 = <&pwm8m2_pins>;
};
