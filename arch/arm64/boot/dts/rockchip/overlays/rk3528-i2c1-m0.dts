/dts-v1/;
/plugin/;
#include <dt-bindings/pinctrl/rockchip.h>

/ {
	metadata {
		title = "Enable I2C1-M0";
		compatible = "radxa,rock-2a", "radxa,rock-2f", "radxa,medge-rk3528a-io";
		category = "misc";
		exclusive = "GPIO4_A2", "GPIO4_A3", "i2c1";
		description = "Enable I2C1-M0.
On Radxa 2A this is SDA pin 27 and SCL pin 28.
On Radxa 2A this is SDA pin 27 and SCL pin 28.
On Radxa mEdge-RK3528A IO this is SDA pin 27 and SCL pin 28.
";
	};
};

&i2c1 {
	status = "okay";
	pinctrl-names = "default";
	pinctrl-0 = <&i2c1m0_xfer>;
};
