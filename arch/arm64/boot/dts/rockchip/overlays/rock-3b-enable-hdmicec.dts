/dts-v1/;
/plugin/;

/ {
	metadata {
		title = "Enable HDMI CEC";
		compatible = "radxa,rock-3b";
		category = "misc";
		description = "Enable HDMI CEC.";
	};
};

&hdmi {
	pinctrl-0 = <&hdmitx_scl &hdmitx_sda &hdmitxm0_cec>;
};
