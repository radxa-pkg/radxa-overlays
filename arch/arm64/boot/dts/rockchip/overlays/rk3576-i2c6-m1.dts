/dts-v1/;
/plugin/;

/ {
	metadata {
		title = "Enable I2C6-M1";
		compatible = "radxa,rock-4d";
		category = "misc";
		exclusive = "GPIO1_C2", "GPIO1_C3", "i2c6";
		description = "Enable I2C6-M1.
On Radxa ROCK 4D this is SDA pin 7 and SCL pin 33.
";
	};
};

&i2c6 {
	status = "okay";
	pinctrl-0 = <&i2c6m1_xfer>;
};
