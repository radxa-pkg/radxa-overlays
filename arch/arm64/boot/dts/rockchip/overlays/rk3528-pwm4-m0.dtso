/dts-v1/;
/plugin/;

/ {
	metadata {
		title = "Enable PWM4-M0";
		compatible = "radxa,rock-2a", "radxa,rock-2f";
		category = "misc";
		exclusive = "GPIO4_B7";
		description = "Enable PWM4-M0.
On Radxa ROCK 2A this is pin 11.
On Radxa ROCK 2F this is pin 11.
";
	};
};

&pwm4 {
	status = "okay";
	pinctrl-names = "active";
	pinctrl-0 = <&pwm4m0_pins>;
};
