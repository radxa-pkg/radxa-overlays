/dts-v1/;
/plugin/;

/ {
	metadata {
		title = "Set OTG port to be controlled by hardware switch";
		compatible = "radxa,rock-pi-4a", "radxa,rock-pi-4b", "radxa,rock-pi-4c", "radxa,rock-pi-4a-plus", "radxa,rock-pi-4b-plus", "radxa,rock-4se";
		category = "misc";
		exclusive = "usbdrd_dwc3_0-dr_mode";
		description = "Set OTG port to OTG mode.";
	};
};

&usbdrd_dwc3_0 {
	status = "okay";
	dr_mode = "otg";
};
