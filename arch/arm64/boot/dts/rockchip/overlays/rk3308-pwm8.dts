/dts-v1/;
/plugin/;

/ {
	metadata {
		title = "Enable PWM8";
		compatible = "radxa,rock-s0";
		category = "misc";
		exclusive = "GPIO2_B2";
		description = "Enable PWM8.
On ROCK S0 this is pin 31.";
	};
};

&pwm8 {
	status = "okay";
	pinctrl-names = "active";
	pinctrl-0 = <&pwm8_pin>;
};
