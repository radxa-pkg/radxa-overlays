/dts-v1/;
/plugin/;

/ {
	metadata {
		title = "Enable I2C2-M1";
		compatible = "radxa,radxa-cm3-io", "radxa,radxa-cm3-sodimm-io";
		category = "misc";
		exclusive = "GPIO4_B4", "GPIO4_B5", "i2c2_pinctrl-0";
		description = "Enable I2C2-M1.\nOn Radxa CM3 IO and Radxa CM3 SODIMM IO this is SDA pin 27 and SCL pin 28.\n";
	};

	fragment@0 {
		target = <&i2c2>;

		__overlay__ {
			status = "okay";
			pinctrl-names = "default";
			pinctrl-0 = <&i2c2m1_xfer>;
		};
	};
};
