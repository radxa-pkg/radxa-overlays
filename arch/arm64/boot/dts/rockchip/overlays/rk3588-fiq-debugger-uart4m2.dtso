/dts-v1/;
/plugin/;

/ {
	metadata {
		title = "Enable FIQ Debugger on UART4-M2";
		compatible = "radxa,rock-5a", "radxa,rock-5c", "radxa,rock-5d";
		category = "misc";
		exclusive = "GPIO1_B3", "GPIO1_B2";
		description = "Enable FIQ Debugger on UART4-M2.
On Radxa ROCK 5A this is TX pin 7 and RX pin 29.
On Radxa ROCK 5B this is TX pin 7 & RX pin 29.
On Radxa ROCK 5C this is TX pin 7 and RX pin 29.
On Radxa ROCK 5D this is TX pin 7 and RX pin 29.
";
	};
};

&fiq_debugger {
	status = "okay";
	rockchip,serial-id = <4>;
	pinctrl-names = "default";
	pinctrl-0 = <&uart4m2_xfer>;
};

&uart4 {
	status = "disabled";
};
