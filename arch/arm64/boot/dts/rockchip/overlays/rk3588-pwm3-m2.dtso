/dts-v1/;
/plugin/;

/ {
	metadata {
		title = "Enable PWM3-M2";
		compatible = "radxa,cm5-rpi-cm4-io";
		category = "misc";
		exclusive = "GPIO1_C2";
		description = "Enable PWM3-M2.
On Radxa CM5 RPI CM4 IO this is pin 11.";
	};
};

&pwm3 {
	status = "okay";
	pinctrl-0 = <&pwm3m2_pins>;
};
