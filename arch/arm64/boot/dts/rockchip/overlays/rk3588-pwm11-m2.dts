/dts-v1/;
/plugin/;

/ {
	metadata {
		title = "Enable PWM11-M2";
		compatible = "unknown";
		category = "misc";
		exclusive = "GPIO1_C4";
		description = "Enable PWM11-M2.
On Radxa CM5 IO this is pin 16.";
	};
};

&pwm11 {
	status = "okay";
	pinctrl-0 = <&pwm11m2_pins>;
};
