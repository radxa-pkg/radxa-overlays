/dts-v1/;
/plugin/;

/ {
	metadata {
		title = "Enable I2C0-M1";
		compatible = "radxa,rock-5b", "radxa,rock-5b-plus", "radxa,rock-5t";
		category = "misc";
		exclusive = "GPIO4_C6", "GPIO4_C5";
		description = "Enable I2C0-M1.
On Radxa ROCK 5B this is SDA pin 27 & SCL pin 28.
On Radxa ROCK 5B+ this is SDA pin 27 & SCL pin 28.
On Radxa ROCK 5T this is SDA pin 27 & SCL pin 28.";
	};
};

&i2c0 {
	status = "okay";
	pinctrl-0 = <&i2c0m1_xfer>;
};
