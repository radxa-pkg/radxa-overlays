/dts-v1/;
/plugin/;

/ {
	metadata {
		title = "Enable spidev on SPI1-M1 over CS0";
		compatible = "rockchip,rk3588";
		category = "misc";
		description = "Enable spidev on SPI1-M1 over CS0.";
	};

	fragment@0 {
		target = <&spi1>;

		__overlay__ {
			status = "okay";
			#address-cells = <1>;
			#size-cells = <0>;
			pinctrl-names = "default";
			pinctrl-0 = <&spi1m1_cs0 &spi1m1_pins>;
			max-freq = <50000000>;

			spidev@0 {
				compatible = "rockchip,spidev";
				status = "okay";
				reg = <0>;
				spi-max-frequency = <50000000>;
			};
		};
	};
};
