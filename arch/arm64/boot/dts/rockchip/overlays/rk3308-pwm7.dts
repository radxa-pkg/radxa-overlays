/dts-v1/;
/plugin/;

/ {
	metadata {
		title = "Enable PWM7";
		compatible = "radxa,rock-s0";
		category = "misc";
		exclusive = "GPIO2_B0";
		description = "Enable PWM7.
On ROCK S0 this is pin 26.";
	};
};

&pwm7 {
	status = "okay";
	pinctrl-names = "active";
	pinctrl-0 = <&pwm7_pin>;
};
