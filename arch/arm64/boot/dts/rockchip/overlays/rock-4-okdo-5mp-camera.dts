/dts-v1/;
/plugin/;

#include "rock-4-ov5647.dtsi"

/ {
	metadata {
		title = "Enable OKdo 5MP Camera";
		compatible = "rockchip,rk3399";
		category = "camera";
		exclusive = "mipi_dphy_rx0";
		description = "Enable OKdo 5MP Camera.";
	};
};

&camera_ov5647 {
	rockchip,camera-module-name = "OKDO-5MP";
};
