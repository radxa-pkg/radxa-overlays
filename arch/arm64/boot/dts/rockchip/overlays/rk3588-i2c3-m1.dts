/dts-v1/;
/plugin/;

#include <dt-bindings/pinctrl/rockchip.h>

/ {
	metadata {
		title = "Enable I2C3-M1";
		compatible = "radxa,rock-5b", "radxa,rock-5b-plus", "radxa,rock-5t";
		category = "misc";
		exclusive = "GPIO3_B7", "GPIO3_C0";
		description = "Enable I2C3-M1.
On Radxa ROCK 5B this is SDA pin 15 & SCL pin 13.
On Radxa ROCK 5B+ this is SDA pin 15 & SCL pin 13.
On Radxa ROCK 5T this is SDA pin 15 & SCL pin 13.";
	};
};

&i2c3 {
	status = "okay";
	pinctrl-0 = <&i2c3m1_xfer>;
};

&i2c3m1_xfer {
	rockchip,pins =
		<3 RK_PB7 9 &pcfg_pull_up>,
		<3 RK_PC0 9 &pcfg_pull_up>;
};
