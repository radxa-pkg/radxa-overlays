/dts-v1/;
/plugin/;

/ {
	metadata {
		title = "Enable PWM4";
		compatible = "radxa,rock-s0";
		category = "misc";
		exclusive = "GPIO0_A1";
		description = "Enable PWM4.
On ROCK S0 this is pin 16.";
	};
};

&pwm4 {
	status = "okay";
	pinctrl-names = "default";
	pinctrl-0 = <&pwm4_pin>;
};
