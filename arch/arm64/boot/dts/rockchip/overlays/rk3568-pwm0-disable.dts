/dts-v1/;
/plugin/;

#include <dt-bindings/pinctrl/rockchip.h>

/ {
	metadata {
		title = "Disable FAN0";
		compatible = "radxa,cm3-io";
		category = "misc";
		exclusive = "fan0";
		description = "Disable FAN0.\nThis will also disable PWM0, so the pin can be used for other functions.";
	};

	fragment@0 {
		target = <&fan0>;

		__overlay__ {
			status = "disabled";
		};
	};

	fragment@1 {
		target = <&pwm0>;

		__overlay__ {
			status = "disabled";
		};
	};
};
