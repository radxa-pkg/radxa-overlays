/dts-v1/;
/plugin/;

/ {
	metadata {
		title = "Enable spidev on SPI0-M0 over CS0";
		compatible = "unknown";
		category = "misc";
		exclusive = "GPIO1_B2", "GPIO1_B1", "GPIO1_B3", "GPIO0_D1";
		description = "Enable spidev on SPI0-M0 over CS0.";
	};
};

&spi0 {
	status = "okay";
	#address-cells = <1>;
	#size-cells = <0>;
	pinctrl-names = "default";
	pinctrl-0 = <&spi0m0_cs0 &spi0m0_pins>;
	max-freq = <50000000>;

	spidev@0 {
		compatible = "rockchip,spidev";
		status = "okay";
		reg = <0>;
		spi-max-frequency = <50000000>;
	};
};
