/dts-v1/;
/plugin/;

#include "rock-3c-ov5647.dtsi"

/ {
	metadata {
		title = "Enable OKdo 5MP Camera";
		compatible = "radxa,rock-3c";
		category = "camera";
		description = "Enable OKdo 5MP Camera.";
	};

	fragment@10 {
		target = <&ov5647>;

		__overlay__ {
			rockchip,camera-module-name = "OKDO-5MP";
		};
	};
};
