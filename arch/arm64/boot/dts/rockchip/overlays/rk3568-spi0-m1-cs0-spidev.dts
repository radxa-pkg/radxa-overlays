/dts-v1/;
/plugin/;

/ {
	metadata {
		title = "Enable spidev on SPI0-M1 over CS0";
		compatible = "unknown";
		category = "misc";
		description = "Enable spidev on SPI0-M1 over CS0.";
	};

	fragment@1 {
		target = <&spi0>;

		__overlay__ {
			status = "okay";
			#address-cells = <1>;
			#size-cells = <0>;
			pinctrl-names = "default", "high_speed";
			pinctrl-0 = <&spi0m1_cs0 &spi0m1_pins>;
			pinctrl-1 = <&spi0m1_cs0 &spi0m1_pins_hs>;
			max-freq = <50000000>;

			spidev@0 {
				compatible = "rockchip,spidev";
				status = "okay";
				reg = <0>;
				spi-max-frequency = <50000000>;
			};
		};
	};
};
