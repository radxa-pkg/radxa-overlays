/dts-v1/;
/plugin/;

/ {
	metadata {
		title = "Enable PWM1-CH2-M1";
		compatible = "radxa,cm4-rpi-cm4-io", "radxa,rock-4d";
		category = "misc";
		exclusive = "GPIO1_C2", "pwm1_6ch_2";
		description = "Enable PWM1-CH2-M1.
On Radxa CM4-RPI-CM4-IO this is pin 32.
On Radxa ROCK 4D this is pin 33.
";
	};
};

&pwm1_6ch_2 {
	status = "okay";
	pinctrl-0 = <&pwm1m1_ch2>;
};
