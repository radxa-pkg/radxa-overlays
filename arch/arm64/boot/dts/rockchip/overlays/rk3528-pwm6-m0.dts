/dts-v1/;
/plugin/;

/ {
	metadata {
		title = "Enable PWM6-M0";
		compatible = "radxa,rock-2a", "radxa,rock-2f", "radxa,medge-rk3528a-io";
		category = "misc";
		exclusive = "GPIO4_C1";
		description = "Enable PWM6-M0.
On Radxa ROCK 2A this is pin 26.
On Radxa ROCK 2F this is pin 26.
On Radxa mEdge-RK3528A IO this is pin 26.
";
	};
};

&pwm6 {
	status = "okay";
	pinctrl-names = "active";
	pinctrl-0 = <&pwm6m0_pins>;
};
