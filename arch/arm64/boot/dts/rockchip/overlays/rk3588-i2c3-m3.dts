/dts-v1/;
/plugin/;

/ {
	metadata {
		title = "Enable I2C3-M3";
		compatible = "radxa,rock-5t-Industrial";
		category = "misc";
		exclusive = "GPIO2_B2", "GPIO2_B3";
		description = "Enable I2C3-M3.
On Radxa ROCK 5T Industria  this is SDA pin 27 & SCL pin 28.";
	};
};

&i2c3 {
	status = "okay";
	pinctrl-0 = <&i2c3m3_xfer>;
};
