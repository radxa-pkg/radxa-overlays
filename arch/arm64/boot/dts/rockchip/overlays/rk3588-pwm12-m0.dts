/dts-v1/;
/plugin/;

/ {
	metadata {
		title = "Enable PWM12-M0";
		compatible = "radxa,rock-5b", "radxa,rock-5b-plus", "radxa,rock-5t";
		category = "misc";
		exclusive = "GPIO3_B5";
		description = "Enable PWM12-M0.
On Radxa ROCK 5B this is pin 12.
On Radxa ROCK 5B+ this is pin 12.
On Radxa ROCK 5T this is pin 12.";
	};
};

&pwm12 {
	status = "okay";
	pinctrl-0 = <&pwm12m0_pins>;
};
