/*
 * Device Tree overlay for the Infineon SLB9670 Trusted Platform Module add-on
 * boards, which can be used as a secure key storage and hwrng.
 * available as "Iridium SLB9670" by Infineon and "LetsTrust TPM" by pi3g.
 * Compatible with RK3399 chips using the GPIO4 as CE1
 */

/dts-v1/;
/plugin/;

/ {
	compatible = "rockchip,rk3399";
	fragment@0 {
		target = <&spi1>;
		__overlay__ {
			status = "okay";

			/* needed to avoid dtc warning */
			#address-cells = <1>;
			#size-cells = <0>;

			slb9670: slb9670@1 {
				compatible = "infineon,slb9670";
				reg = <1>;	/* CE1 */
				#address-cells = <1>;
				#size-cells = <0>;
				spi-max-frequency = <1000000>;
				status = "okay";
			};
		};
	};
};
