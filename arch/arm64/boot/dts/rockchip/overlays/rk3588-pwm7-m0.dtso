/dts-v1/;
/plugin/;

/ {
	metadata {
		title = "Enable PWM7-M0";
		compatible = "radxa,rock-5a", "radxa,rock-5c", "radxa,rock-5d", "radxa,cm5-io", "radxa,cm5-rpi-cm4-io";
		category = "misc";
		exclusive = "GPIO0_D0";
		description = "Enable PWM7-M0.
On Radxa ROCK 5A this is pin 28.
On Radxa ROCK 5C this is pin 28.
On Radxa ROCK 5D this is pin 28.
On Radxa CM5 IO this is pin 29.
On Radxa CM5 RPI CM4 IO this is pin 3.
";
	};
};

&pwm7 {
	status = "okay";
	pinctrl-0 = <&pwm7m0_pins>;
};
