/dts-v1/;
/plugin/;

/ {
	metadata {
		title = "Enable PWM5";
		compatible = "radxa,radxa-cm3-sodimm-io", "radxa,e23";
		category = "misc";
		exclusive = "GPIO0_C4";
		description = "Enable PWM5.\nOn Radxa CM3 SODIMM IO this is on pin 20.\nOn Radxa E23 this is on pin 13.";
	};

	fragment@0 {
		target = <&pwm5>;

		__overlay__ {
			status = "okay";
			pinctrl-names = "active";
			pinctrl-0 = <&pwm5_pins>;
		};
	};
};
