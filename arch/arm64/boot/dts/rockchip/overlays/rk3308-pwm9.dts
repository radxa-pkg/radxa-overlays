/dts-v1/;
/plugin/;

/ {
	metadata {
		title = "Enable PWM9";
		compatible = "radxa,rock-s0";
		category = "misc";
		exclusive = "GPIO2_B3";
		description = "Enable PWM9.
On ROCK S0 this is pin 22.";
	};
};

&pwm9 {
	status = "okay";
	pinctrl-names = "default";
	pinctrl-0 = <&pwm9_pin>;
};
