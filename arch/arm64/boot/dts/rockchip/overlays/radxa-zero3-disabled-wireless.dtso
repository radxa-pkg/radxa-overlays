/dts-v1/;
/plugin/;

#include <dt-bindings/gpio/gpio.h>
#include <dt-bindings/pinctrl/rockchip.h>


/ {
	metadata {
		title = "Disabled Zero 3E Wireless";
		compatible = "radxa,zero3";
		category = "misc";
		description = "Disabled Zero 3E Wireless.";
	};
};

&uart1 {
	status = "disabled";
};

&sdmmc1 {
	status = "disabled";
};
