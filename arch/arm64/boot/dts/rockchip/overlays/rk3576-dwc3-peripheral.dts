/dts-v1/;
/plugin/;

/ {
	metadata {
		title = "Set OTG port 0 to Peripheral mode";
		compatible = "radxa,cm4-io", "radxa,rock-4d";
		category = "misc";
		exclusive = "usb_drd0_dwc3-dr_mode";
		description = "Set OTG port 0 to Peripheral mode.
Use this when you want to connect to another computer.";
	};
};

&usb_drd0_dwc3 {
	status = "okay";
	dr_mode = "peripheral";
};
