#include "rock-5a-rpi-camera-v2.dtso"

/ {
	metadata {
		title ="Enable Raspberry Pi Camera v2 on the Camera connector";
		compatible = "radxa,rock-5d";
		description = "Enable Raspberry Pi Camera v2 on the Camera connector.
The Camera connector is located on the bottom of the board.
This is not the top MIPI-RX* connectors.
";
	};
};
