/dts-v1/;
/plugin/;

/ {
	metadata {
		title = "Enable FIQ Debugger on UART9-M1";
		compatible = "radxa,rock-3b", "radxa,rock-3c";
		category = "misc";
		exclusive = "GPIO4_C5", "GPIO4_C6";
		description = "Enable FIQ Debugger on UART9-M1.\nOn Radxa ROCK 3B this TX pin 21 & RX pin 24.\nOn Radxa ROCK 3C this is TX pin 21 and RX pin 24.";
	};

	fragment@0 {
		target = <&fiq_debugger>;

		__overlay__ {
			status = "okay";
			rockchip,serial-id = <9>;
			pinctrl-names = "default";
			pinctrl-0 = <&uart9m1_xfer>;
		};
	};

	fragment@1 {
		target = <&uart9>;

		__overlay__ {
			status = "disabled";
		};
	};
};
