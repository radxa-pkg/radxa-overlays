/dts-v1/;
/plugin/;

/ {
	metadata {
		title = "Set OTG port 0 to OTG mode";
		compatible = "unknown";
		category = "misc";
		exclusive = "usbdrd_dwc3-dr_mode";
		description = "Set OTG port 0 to OTG mode.
Use this for automatic USB role switching.";
	};
};

&usbdrd_dwc3_0 {
	status = "okay";
	dr_mode = "otg";
	usb-role-switch;
};
