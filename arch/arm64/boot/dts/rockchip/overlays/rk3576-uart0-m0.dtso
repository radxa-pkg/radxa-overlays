/dts-v1/;
/plugin/;

/ {
	metadata {
		title = "Enable UART0-M0";
		compatible = "radxa,cm4-rpi-cm4-io", "radxa,cm4-io", "radxa,rock-4d";
		category = "misc";
		exclusive = "GPIO0_D4", "GPIO0_D5", "uart0";
		description = "Enable UART0-M0.
On Radxa CM4 RPI CM4 IO this is RX pin 10 and TX pin 8.
On Radxa CM4 IO this is RX pin 10 and TX pin 8.
On Radxa ROCK 4D this is RX pin 10 and TX pin 8.
";
	};
};

&uart0 {
	status = "okay";
	pinctrl-0 = <&uart0m0_xfer>;
};
