/dts-v1/;
/plugin/;

/ {
	metadata {
		title = "Enable UART3-M1";
		compatible = "radxa,rock-3a";
		category = "misc";
		exclusive = "GPIO3_B7", "GPIO3_C0";
		description = "Enable UART3-M1.\nOn Radxa ROCK 3A <= v1.2 this RX pin 37 & TX pin 7.";
	};

	fragment@0 {
		target = <&uart3>;

		__overlay__ {
			status = "okay";
			pinctrl-names = "default";
			pinctrl-0 = <&uart3m1_xfer>;
		};
	};
};
