/dts-v1/;
/plugin/;

/ {
	metadata {
		title = "Disable HDMI CEC";
		compatible = "radxa,rock-3b";
		category = "misc";
		description = "Disable HDMI CEC.";
	};

	fragment@0 {
		target = <&hdmi>;

		__overlay__ {
			pinctrl-0 = <&hdmitx_scl &hdmitx_sda>;
		};
	};
};