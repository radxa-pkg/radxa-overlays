/dts-v1/;
/plugin/;

/ {
		metadata {
				title = "Enable I2C7";
				compatible = "rockchip,rk3399";
				category = "misc";
				description = "Enable I2C7";
		};

		fragment@0 {
				target = <&i2c7>;

				__overlay__ {
						status = "okay";
						pinctrl-names = "default";
						pinctrl-0 = <&i2c7_xfer>;
				};
		};
};
