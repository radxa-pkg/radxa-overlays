/dts-v1/;
/plugin/;

/ {
	metadata {
		title = "Enable UART8-M0";
		compatible = "radxa,rock-5a", "radxa,rock-5c", "radxa,rock-5d";
		category = "misc";
		exclusive= "GPIO4_B0", "GPIO4_B1";
		description = "Enable UART8-M0.
On Radxa ROCK 5A this is TX pin 32 and RX pin 40.
On Radxa ROCK 5C this is TX pin 32 and RX pin 40.
On Radxa ROCK 5D this is TX pin 32 and RX pin 40.
";
	};
};

&uart8 {
	status = "okay";
	pinctrl-0 = <&uart8m0_xfer>;
};
