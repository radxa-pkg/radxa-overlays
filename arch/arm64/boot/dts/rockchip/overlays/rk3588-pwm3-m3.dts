/dts-v1/;
/plugin/;

/ {
	metadata {
		title = "Enable PWM3-M3";
		compatible = "radxa,cm5-rpi-cm4-io";
		category = "misc";
		exclusive = "GPIO1_A7";
		description = "Enable PWM3-M3.
On Radxa CM5 RPI CM4 IO this is pin 16.";
	};
};

&pwm3 {
	status = "okay";
	pinctrl-0 = <&pwm3m3_pins>;
};
