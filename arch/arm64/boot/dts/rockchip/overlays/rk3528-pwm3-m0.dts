/dts-v1/;
/plugin/;

/ {
	metadata {
		title = "Enable PWM3-M0";
		compatible = "radxa,rock-2a";
		category = "misc";
		exclusive = "GPIO4_C6";
		description = "Enable PWM3-M0.
On Radxa ROCK 2A this is pin 15.";
	};
};

&pwm3 {
	status = "okay";
	pinctrl-names = "active";
	pinctrl-0 = <&pwm3m0_pins>;
};
