/dts-v1/;
/plugin/;

/{
	metadata {
		title = "Enable spidev on SPI1";
		compatible = "unknown";
		category = "misc";
		exclusive = "GPOI3_B2", "GPOI3_B3", "GPOI3_B4", "GPOI3_B5";
		description = "Enable spidev on SPI1 on pin 39, 40, 41 & 42.";
	};
};

&spi1 {
	status = "okay";
	pinctrl-names = "default";
	pinctrl-0 = <&spi1_clk &spi1_csn0 &spi1_miso &spi1_mosi>;
	#address-cells = <1>;
	#size-cells = <0>;

	spidev@0 {
		compatible = "rockchip,spidev", "armbian,spi-dev";
		reg = <0>;
		spi-max-frequency = <50000000>;
	};
};
