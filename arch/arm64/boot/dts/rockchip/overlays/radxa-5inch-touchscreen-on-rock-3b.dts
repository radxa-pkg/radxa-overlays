/dts-v1/;
/plugin/;

#include "rock-3ab-radxa-5inch-touchscreen.dtsi"

/ {
	metadata {
		title = "Enable Radxa 5-inch Touchscreen";
		compatible = "radxa,rock-3b";
		category = "display";
		description = "Enable Radxa 5-inch Touchscreen.";
	};
};