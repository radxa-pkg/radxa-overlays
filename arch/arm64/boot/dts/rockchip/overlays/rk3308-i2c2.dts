/dts-v1/;
/plugin/;

/ {
	metadata {
		title = "Enable I2C2";
		compatible = "radxa,s0";
		category = "misc";
		exclusive = "GPIO2_A2", "GPIO2_A3";
		description = "Enable I2C2.\nOn Radxa S0 this is SDA pin 37 & SCL pin 13.";
    };

	fragment@0 {
		target = <&i2c2>;

		__overlay__ {
			status = "okay";
			pinctrl-names = "default";
			pinctrl-0 = <&i2c2_xfer>;
		};
	};
};
