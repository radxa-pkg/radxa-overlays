/dts-v1/;
/plugin/;

/ {
	metadata {
		title = "Enable I2C6-M3";
		compatible = "radxa,rock-5a", "radxa,rock-5c", "radxa,rock-5d";
		category = "misc";
		exclusive = "GPIO4_B0", "GPIO4_B1";
		description = "Enable I2C6-M3.
On Radxa ROCK 5A this is SDA pin 32 and SCL pin 40.
On Radxa ROCK 5C this is SDA pin 32 and SCL pin 40.
On Radxa ROCK 5D this is SDA pin 32 and SCL pin 40.
";
	};
};

&i2c6 {
	status = "okay";
	pinctrl-0 = <&i2c6m3_xfer>;
};
