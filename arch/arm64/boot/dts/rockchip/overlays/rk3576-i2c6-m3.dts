/dts-v1/;
/plugin/;

/ {
	metadata {
		title = "Enable I2C6-M3";
		compatible = "unknown";
		category = "misc";
		exclusive = "GPIO4_C6", "GPIO4_C7", "i2c6";
		description = "Enable I2C6-M3.";
	};
};

&i2c6 {
	status = "okay";
	pinctrl-0 = <&i2c6m3_xfer>;
};
