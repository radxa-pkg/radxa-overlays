/dts-v1/;
/plugin/;

/ {
	metadata {
		title = "Enable CAN1-M1";
		compatible = "unknown";
		category = "misc";
		description = "Enable CAN1-M1.\nOn ROCK 3C this is TX pin 19 & RX pin 23.";
	};

	fragment@0 {
		target = <&can1>;

		__overlay__ {
			status = "okay";
			assigned-clocks = <&cru 323>;
			assigned-clock-rates = <100000000>;
			pinctrl-names = "default";
			pinctrl-0 = <&can1m1_pins>;
		};
	};
};
