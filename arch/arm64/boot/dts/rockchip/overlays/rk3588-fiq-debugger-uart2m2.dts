/dts-v1/;
/plugin/;

/ {
	metadata {
		title = "Enable FIQ Debugger on UART2-M2";
		compatible = "radxa,rock-5b", "radxa,rock-5b-plus", "radxa,rock-5t";
		category = "misc";
		exclusive = "GPIO3_B1", "GPIO3_B2";
		description = "Enable FIQ Debugger on UART2-M2.
On Radxa ROCK 5B this is TX pin 36 & RX pin 38.
On Radxa ROCK 5B+ this is TX pin 36 & RX pin 38.
On Radxa ROCK 5T this is TX pin 36 & RX pin 38.";
	};
};

&fiq_debugger {
	status = "okay";
	rockchip,serial-id = <2>;
	pinctrl-names = "default";
	pinctrl-0 = <&uart2m2_xfer>;
};

&uart2 {
	status = "disabled";
};
