/dts-v1/;
/plugin/;

/ {
	metadata {
		title = "Enable PWM13-M1";
		compatible = "radxa,nx5-io";
		category = "misc";
		exclusive = "GPIO3_B6";
		description = "Enable PWM13-M1.
On Radxa NX5 IO this is pin 29.";
	};
};

&pwm13 {
	status = "okay";
	pinctrl-0 = <&pwm13m1_pins>;
};
