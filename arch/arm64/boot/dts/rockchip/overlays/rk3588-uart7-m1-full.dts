/dts-v1/;
/plugin/;

/ {
	metadata {
		title = "Enable UART7-M1 with Hardware Flow Control";
		compatible = "radxa,rock-5b";
		category = "misc";
		description = "Enable UART7-M1 with hardware flow control.";
	};

	fragment@0 {
		target = <&uart7>;

		__overlay__ {
			status = "okay";
			pinctrl-0 = <&uart7m1_xfer &uart7m1_ctsn &uart7m1_rtsn>;
		};
	};
};
