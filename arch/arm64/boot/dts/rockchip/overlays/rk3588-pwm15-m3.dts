/dts-v1/;
/plugin/;

/ {
	metadata {
		title = "Enable PWM15-M3";
		compatible = "radxa,rock-5a", "radxa,rock-5b", "radxa,rock-5c", "radxa,rock-5d", "radxa,cm5-rpi-cm4-io";
		category = "misc";
		exclusive = "GPIO1_D7";
		description = "Enable PWM15-M3.
On Radxa ROCK 5A this is pin 3.
On Radxa ROCK 5B this is pin 29.
On Radxa ROCK 5C this is pin 3.
On Radxa ROCK 5D this is pin 3.
On Radxa CM5-RPI-CM4-IO this is pin 27.
";
	};
};

&pwm15 {
	status = "okay";
	pinctrl-0 = <&pwm15m3_pins>;
};
