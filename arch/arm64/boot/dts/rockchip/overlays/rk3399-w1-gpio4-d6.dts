/dts-v1/;
/plugin/;

#include <dt-bindings/gpio/gpio.h>
#include <dt-bindings/pinctrl/rockchip.h>

/ {
	metadata {
		title = "Enable 1-Wire on GPIO4_D6";
		compatible = "rockchip,rk3399";
		category = "misc";
		exclusive = "GPIO4_D6";
		description = "Enable 1-Wire on GPIO4_D6.
On ROCK 4 this is pin 37.";
	};
};

&{/} {
	w1: onewire {
		compatible = "w1-gpio";
		pinctrl-names = "default";
		gpios = <&gpio4 RK_PD6 GPIO_ACTIVE_HIGH>;
		status = "okay";
	};
};
