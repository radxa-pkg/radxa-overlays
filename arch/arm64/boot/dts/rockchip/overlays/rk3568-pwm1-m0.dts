/dts-v1/;
/plugin/;

/ {
	metadata {
		title = "Enable PWM1-M0";
		compatible = "unknown";
		category = "misc";
		description = "Enable PWM1-M0.";
	};

	fragment@0 {
		target = <&pwm1>;

		__overlay__ {
			status = "okay";
			pinctrl-names = "active";
			pinctrl-0 = <&pwm1m0_pins>;
		};
	};
};
