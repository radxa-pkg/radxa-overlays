/dts-v1/;
/plugin/;

#include <dt-bindings/gpio/gpio.h>
#include <dt-bindings/pinctrl/rockchip.h>

/ {
	metadata {
		title = "Enable 1-Wire on GPIO1_C7";
		compatible = "radxa,nx5-io";
		category = "misc";
		exclusive = "GPIO1_C7";
		description = "Enable 1-Wire on GPIO1_C7.
On Radxa NX5 IO this is pin 40.";
	};
};

&{/} {
	w1: onewire {
		compatible = "w1-gpio";
		gpios = <&gpio1 RK_PC7 GPIO_ACTIVE_HIGH>;
		status = "okay";
	};
};
