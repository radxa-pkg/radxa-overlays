/dts-v1/;
/plugin/;

/ {
	metadata {
		title = "Enable PWM2-CH2-M1";
		compatible = "unknown";
		category = "misc";
		exclusive = "GPIO4_C6", "pwm2_8ch_2";
		description = "Enable PWM2-CH2-M1.";
	};
};

&pwm2_8ch_2 {
	status = "okay";
	pinctrl-0 = <&pwm2m1_ch2>;
};
