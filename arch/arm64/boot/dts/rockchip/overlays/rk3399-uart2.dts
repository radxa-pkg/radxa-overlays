/dts-v1/;
/plugin/;

/ {
	metadata {
		title = "Enable UART2";
		compatible = "rockchip,rk3399";
		category = "misc";
		exclusive = "GPIO4_C4", "GPIO4_C3";
		description = "Enable UART2.";
	};

	fragment@0 {
		target = <&uart2>;

		__overlay__ {
			status = "okay";
			pinctrl-names = "default";
			pinctrl-0 = <&uart2c_xfer>;
		};
	};
};
