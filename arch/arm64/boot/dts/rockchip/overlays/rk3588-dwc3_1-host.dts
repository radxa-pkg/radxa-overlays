/dts-v1/;
/plugin/;

/ {
	metadata {
		title = "Set OTG port 1 to Host mode";
		compatible = "radxa,rock-5b-plus";
		category = "misc";
		exclusive = "usbdrd_dwc3_1-dr_mode";
		description = "Set OTG port 1 to Host mode.
Use this when you want to connect USB devices.";
	};
};

&usbdrd_dwc3_1 {
	status = "okay";
	dr_mode = "host";
};
