// ROCK 2A USB OTG
/dts-v1/;
/plugin/;

/ {
	metadata {
		title = "Set OTG port to be controlled by hardware switch";
		compatible = "radxa,rock-2a", "radxa,rock-2f", "radxa,medge-rk3528a-io";
		category = "misc";
		exclusive = "usbdrd_dwc3-dr_mode";
		description = "Set OTG port to be controlled by hardware switch.";
	};
};

&usbdrd_dwc3 {
	status = "okay";
	dr_mode = "otg";
};
