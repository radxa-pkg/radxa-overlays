/dts-v1/;
/plugin/;

/ {
	metadata {
		title = "Enable UART6-M2";
		compatible = "radxa,nx5-io";
		category = "misc";
		exclusive= "GPIO1_D0", "GPIO1_D1";
		description = "Enable UART6-M2.
On Radxa NX5 IO this is TX pin 22 & RX pin 37.
";
	};
};

&uart6 {
	status = "okay";
	pinctrl-0 = <&uart6m2_xfer>;
};
