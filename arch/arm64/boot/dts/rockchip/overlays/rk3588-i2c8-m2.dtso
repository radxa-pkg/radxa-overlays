/dts-v1/;
/plugin/;

/ {
	metadata {
		title = "Enable I2C8-M2";
		compatible = "radxa,rock-5a", "radxa,rock-5c", "radxa,rock-5d", "radxa,cm5-rpi-cm4-io";
		category = "misc";
		exclusive = "GPIO1_D6", "GPIO1_D7";
		description = "Enable I2C8-M2.
On Radxa ROCK 5A this is SDA pin 3 and SCL pin 5.
On Radxa ROCK 5C this is SDA pin 3 and SCL pin 5.
On Radxa ROCK 5D this is SDA pin 3 and SCL pin 5.
On Radxa CM5-RPI-CM4-IO this is SDA pin 27 and SCL pin 28.
";
	};
};

&i2c8 {
	status = "okay";
	pinctrl-0 = <&i2c8m2_xfer>;
};
