/dts-v1/;
/plugin/;

/ {
	metadata {
		title = "Enable PWM15-M1";
		compatible = "radxa,rock-5a";
		category = "misc";
		exclusive = "GPIO4_B3";
		description = "Enable PWM15-M1.\nOn Radxa ROCK 5A this is pin 11.";
	};

	fragment@0 {
		target = <&pwm15>;

		__overlay__ {
			status = "okay";
			pinctrl-0 = <&pwm15m1_pins>;
		};
	};
};
