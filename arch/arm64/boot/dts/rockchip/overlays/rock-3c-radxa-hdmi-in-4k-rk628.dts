#include "radxa-zero3-radxa-hdmi-in-4k-rk628.dts"

/ {
	metadata {
		compatible = "radxa,rock-3c";
		exclusive = "csi2_dphy0", "GPIO0_C4", "GPIO3_B3", "GPIO3_C6", "GPIO3_B4";
	};
};

&{/} {
	vcc_camera: vcc-camera {
		status = "okay";
		compatible = "regulator-fixed";
		regulator-name = "vcc_camera";
		gpio = <&gpio0 RK_PC4 GPIO_ACTIVE_HIGH>;
		enable-active-high;
		regulator-min-microvolt = <3300000>;
		regulator-max-microvolt = <3300000>;
		regulator-always-on;
	};
};
