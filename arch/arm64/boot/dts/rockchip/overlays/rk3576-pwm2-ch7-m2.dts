/dts-v1/;
/plugin/;

/ {
	metadata {
		title = "Enable PWM2-CH7-M2";
		compatible = "radxa,cm4-rpi-cm4-io";
		category = "misc";
		exclusive = "GPIO2_D7", "pwm2_8ch_7";
		description = "Enable PWM2-CH7-M2.
On Radxa CM4-RPI-CM4-IO this is pin 22.";
	};
};

&pwm2_8ch_7 {
	status = "okay";
	pinctrl-0 = <&pwm2m2_ch7>;
};
