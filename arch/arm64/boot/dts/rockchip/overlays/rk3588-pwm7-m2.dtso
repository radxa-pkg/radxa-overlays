/dts-v1/;
/plugin/;

/ {
	metadata {
		title = "Enable PWM7-M2";
		compatible = "radxa,nx5-io", "radxa,cm5-rpi-cm4-io";
		category = "misc";
		exclusive = "GPIO1_C3";
		description = "Enable PWM7-M2.
On Radxa NX5 IO this is pin 12.
On Radxa CM5 RPI CM4 IO this is pin 15.";
	};
};

&pwm7 {
	status = "okay";
	pinctrl-0 = <&pwm7m2_pins>;
};
