/dts-v1/;
/plugin/;

/ {
	metadata {
		title = "Disable vcc5v0_host regulator";
		compatible = "radxa,rock-4se";
		category = "misc";
		exclusive = "vcc5v0_host", "GPIO4_D1";
		description = "Disable vcc5v0_host regulator.
On ROCK 4SE, this controls the power to non-OTG ports.
You can use `gpioset -m wait 4 25=<0/1>` to control the port power.";
	};
};

&vcc5v0_host {
	gpio = <0>;
};
