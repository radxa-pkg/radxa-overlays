/dts-v1/;
/plugin/;

/ {
	metadata {
		title = "Enable PWM1-M1";
		compatible = "radxa,rock-3a", "radxa,rock-3b", "radxa,radxa-cm3-io", "radxa,radxa-cm3-sodimm-io", "radxa,e23";
		category = "misc";
		exclusive = "GPIO0_B5";
		description = "Enable PWM1-M1.\nOn Radxa ROCK 3A hardware V1.2 and Radxa E23 this is on pin 28.\nOn Radxa ROCK 3A hardware V1.3/1.31 and ROCK 3B this is pin 7.\nOn Radxa CM3 IO this is pin 5.\nOn Radxa CM3 SODIMM IO this is pin 13.";
	};

	fragment@0 {
		target = <&pwm1>;

		__overlay__ {
			status = "okay";
			pinctrl-names = "active";
			pinctrl-0 = <&pwm1m1_pins>;
		};
	};
};
