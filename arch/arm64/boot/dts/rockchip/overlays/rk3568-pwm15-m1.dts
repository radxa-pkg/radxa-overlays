/dts-v1/;
/plugin/;

/ {
	metadata {
		title = "Enable PWM15-M1";
		compatible = "radxa,rock-3c";
		category = "misc";
		exclusive = "GPIO4_C3";
		description = "Enable PWM15-M1.\nOn Radxa ROCK 3B this is pin 19.";
	};

	fragment@0 {
		target = <&pwm15>;

		__overlay__ {
			status = "okay";
			pinctrl-names = "active";
			pinctrl-0 = <&pwm15m1_pins>;
		};
	};
};
