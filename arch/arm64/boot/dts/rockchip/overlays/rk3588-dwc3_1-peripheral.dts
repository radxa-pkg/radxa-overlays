/dts-v1/;
/plugin/;

/ {
	metadata {
		title = "Set OTG port 1 to Peripheral mode (ROCK 5B V1.46+)";
		compatible = "radxa,rock-5b";
		category = "misc";
		exclusive = "usbdrd_dwc3_1-dr_mode";
		description = "Set OTG port 1 to Peripheral mode (ROCK 5B V1.46+).\nUse this when you want to connect to another computer.";
	};

	fragment@0 {
		target = <&usbdrd_dwc3_1>;

		__overlay__ {
			status = "okay";
			dr_mode = "peripheral";
		};
	};
};
