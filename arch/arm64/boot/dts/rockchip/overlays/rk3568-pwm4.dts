/dts-v1/;
/plugin/;

/ {
	metadata {
		title = "Enable PWM4";
		compatible = "radxa,cm3-io", "radxa,cm3-rpi-cm4-io";
		category = "misc";
		exclusive = "GPIO0_C3";
		description = "Enable PWM4.\nOn Radxa CM3 IO this is pin 15.\nOn Radxa CM3 RPI CM4 this is on pin 15.";
	};

	fragment@0 {
		target = <&pwm4>;

		__overlay__ {
			status = "okay";
			pinctrl-names = "active";
			pinctrl-0 = <&pwm4_pins>;
		};
	};
};
