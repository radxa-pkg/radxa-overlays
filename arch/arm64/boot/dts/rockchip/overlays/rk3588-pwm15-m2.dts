/dts-v1/;
/plugin/;

/ {
	metadata {
		title = "Enable PWM15-M2";
		compatible = "radxa,cm5-io";
		category = "misc";
		exclusive = "GPIO1_C6";
		description = "Enable PWM15-M2.
On Radxa CM5 IO this is pin 36.";
	};
};

&pwm15 {
	status = "okay";
	pinctrl-0 = <&pwm15m2_pins>;
};
