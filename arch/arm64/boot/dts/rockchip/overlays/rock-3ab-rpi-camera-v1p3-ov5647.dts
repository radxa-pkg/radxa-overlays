/dts-v1/;
/plugin/;

#include "rock-3-ov5647.dtsi"

/ {
	metadata {
		title = "Enable Raspberry Pi Camera v1.3";
		compatible = "radxa,rock-3a", "radxa,rock-3b";
		category = "camera";
		description = "Enable Raspberry Pi Camera v1.3.";
	};
};
