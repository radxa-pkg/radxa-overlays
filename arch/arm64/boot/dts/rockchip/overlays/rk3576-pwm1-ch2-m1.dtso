/dts-v1/;
/plugin/;

/ {
	metadata {
		title = "Enable PWM1-CH2-M1";
		compatible = "radxa,cm4-rpi-cm4-io", "radxa,cm4-io", "radxa,rock-4d", "radxa,nx4-c200";
		category = "misc";
		exclusive = "GPIO1_C2", "pwm1_6ch_2";
		description = "Enable PWM1-CH2-M1.
On Radxa CM4 RPI CM4 IO this is pin 11.
On Radxa CM4 IO this is pin 33.
On Radxa C200 NX4 IO this is pin 33.
On Radxa ROCK 4D this is pin 33.
";
	};
};

&pwm1_6ch_2 {
	status = "okay";
	pinctrl-0 = <&pwm1m1_ch2>;
};
