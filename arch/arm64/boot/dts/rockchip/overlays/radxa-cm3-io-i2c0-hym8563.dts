/dts-v1/;
/plugin/;

/ {
	metadata {
		title = "Enable HYM8563 RTC on I2C0";
		compatible = "unknown";
		category = "misc";
		description = "Enable HYM8563 RTC on I2C0.";
	};
};

&i2c0 {
	status = "okay";
	#address-cells = <1>;
	#size-cells = <0>;

	hym8563: hym8563@51 {
		compatible = "haoyu,hym8563";
		reg = <0x51>;
	};
};
