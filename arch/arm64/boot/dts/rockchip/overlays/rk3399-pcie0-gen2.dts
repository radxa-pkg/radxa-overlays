/dts-v1/;
/plugin/;

/ {
	metadata {
		title = "Enable PCI Express Gen 2 negotiation (Deprecated)";
		compatible = "radxa,rock-pi-4a", "radxa,rock-pi-4b", "radxa,rock-pi-4c", "radxa,rock-pi-4a-plus", "radxa,rock-pi-4b-plus", "radxa,rock-4se";
		category = "misc";
		exclusive = "pcie0_max-link-speed";
		description = "Enable PCI Express Gen 2 negotiation. 
Deprecated as the latest system has enabled it by default";
	};
};

&pcie0 {
	max-link-speed = <2>;
};
