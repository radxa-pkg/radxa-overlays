/dts-v1/;
/plugin/;

#include <dt-bindings/gpio/gpio.h>
#include <dt-bindings/pinctrl/rockchip.h>

/ {
	metadata {
		title = "Enable 1-Wire on GPIO4_B1";
		compatible = "radxa,rock-5a", "radxa,rock-5c", "radxa,rock-5d";
		category = "misc";
		exclusive = "GPIO4_B1";
		description = "Enable 1-Wire on GPIO4_B1.
On Radxa ROCK 5A this is pin 40.
On Radxa ROCK 5C this is pin 40.
On Radxa ROCK 5D this is pin 40.
";
	};
};

&{/} {
	w1: onewire {
		compatible = "w1-gpio";
		gpios = <&gpio4 RK_PB1 GPIO_ACTIVE_HIGH>;
		status = "okay";
	};
};
