/dts-v1/;
/plugin/;

/ {
	metadata {
		title = "Enable I2C2-M4";
		compatible = "radxa,rock-5a", "radxa,rock-5c", "radxa,rock-5d";
		category = "misc";
		exclusive = "GPIO1_A0", "GPIO1_A1";
		description = "Enable I2C2-M4.
On Radxa ROCK 5A this is SDA pin 21 and SCL pin 19.
On Radxa ROCK 5C this is SDA pin 21 and SCL pin 19.
On Radxa ROCK 5D this is SDA pin 21 and SCL pin 19.
";
	};
};

&i2c2 {
	status = "okay";
	pinctrl-0 = <&i2c2m4_xfer>;
};
