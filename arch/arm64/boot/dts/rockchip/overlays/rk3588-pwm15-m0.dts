/dts-v1/;
/plugin/;

/ {
	metadata {
		title = "Enable PWM15-M0";
		compatible = "radxa,rock-5b", "radxa,rock-5b-plus", "radxa,rock-5t";
		category = "misc";
		exclusive = "GPIO3_C3";
		description = "Enable PWM15-M0.
On Radxa ROCK 5B this is pin 7.
On Radxa ROCK 5B+ this is pin 7.
On Radxa ROCK 5T this is pin 7.";
	};
};

&pwm15 {
	status = "okay";
	pinctrl-0 = <&pwm15m0_pins>;
};
