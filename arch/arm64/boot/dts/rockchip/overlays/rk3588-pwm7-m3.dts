/dts-v1/;
/plugin/;

/ {
	metadata {
		title = "Enable PWM7-M3";
		compatible = "rockchip,rk3588";
		category = "misc";
		description = "Enable PWM7-M3.";
	};

	fragment@0 {
		target = <&pwm7>;

		__overlay__ {
			status = "okay";
			pinctrl-0 = <&pwm7m3_pins>;
		};
	};
};
