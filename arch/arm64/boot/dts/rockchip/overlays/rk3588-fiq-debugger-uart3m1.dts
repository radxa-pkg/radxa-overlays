/dts-v1/;
/plugin/;

/ {
	metadata {
		title = "Enable FIQ Debugger on UART3-M1";
		compatible = "radxa,rock-5b", "radxa,rock-5b-plus", "radxa,rock-5t";
		category = "misc";
		exclusive = "GPIO3_B5", "GPIO3_B6";
		description = "Enable FIQ Debugger on UART3-M1.
On Radxa ROCK 5B this is TX pin 12 & RX pin 35.
On Radxa ROCK 5B+ this is TX pin 12 & RX pin 35.
On Radxa ROCK 5T this is TX pin 12 & RX pin 35.";
	};
};

&fiq_debugger {
	status = "okay";
	rockchip,serial-id = <3>;
	pinctrl-names = "default";
	pinctrl-0 = <&uart3m1_xfer>;
};

&uart3 {
	status = "disabled";
};
