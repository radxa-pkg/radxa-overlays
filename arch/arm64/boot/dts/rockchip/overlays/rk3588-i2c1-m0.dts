#include "rk3588-disable-fiq-debugger.dts"

/ {
	metadata {
		title = "Enable I2C1-M0";
		compatible = "radxa,rock-5a", "radxa,rock-5c", "radxa,rock-5d", "radxa,nx5-io", "radxa,cm5-io", "radxa,cm5-rpi-cm4-io";
		category = "misc";
		exclusive = "GPIO0_B5", "GPIO0_B6", "fiq_debugger";
		description = "Enable I2C1-M0.
On Radxa ROCK 5A this is SDA pin 10 & SCL pin 8.
On Radxa ROCK 5C this is SDA pin 10 & SCL pin 8.
On Radxa ROCK 5D this is SDA pin 10 & SCL pin 8.
On Radxa NX5 IO this is SDA pin 10 & SCL pin 8.
On Radxa CM5 IO this is SDA pin 10 & SCL pin 8.
On Radxa CM5 IO this is SDA pin 10 & SCL pin 8.
";
	};
};

&i2c1 {
	status = "okay";
	pinctrl-0 = <&i2c1m0_xfer>;
};
