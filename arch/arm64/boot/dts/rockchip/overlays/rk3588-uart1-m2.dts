/dts-v1/;
/plugin/;

/ {
	metadata {
		title = "Enable UART1-M2";
		compatible = "radxa,nx5-io";
		category = "misc";
		exclusive = "GPIO0_D1", "GPIO0_D2";
		description = "Enable UART1-M2.
On Radxa NX5 IO this is TX pin 28 and RX pin 27.";
	};
};

&uart1 {
	status = "okay";
	pinctrl-0 = <&uart1m2_xfer>;
};
