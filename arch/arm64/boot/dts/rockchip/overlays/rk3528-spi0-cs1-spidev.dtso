/dts-v1/;
/plugin/;
#include <dt-bindings/gpio/gpio.h>
#include <dt-bindings/pinctrl/rockchip.h>

/ {
	metadata {
		title = "Enable spidev on SPI0 over CS1";
		compatible = "radxa,rock-2a", "radxa,rock-2f", "radxa,medge-rk3528a-io";
		category = "misc";
		exclusive = "GPIO4_B2", "GPIO4_B3", "GPIO4_B4", "GPIO4_C1";
		description = "Enable spidev on SPI0 over CS1.";
	};
};

&spi0 {
	status = "okay";
	#address-cells = <1>;
	#size-cells = <0>;
	max-freq = <50000000>;
	num-cs = <2>;

	spidev@1 {
		compatible = "rockchip,spidev";
		status = "okay";
		reg = <1>;
		spi-max-frequency = <50000000>;
	};
};
