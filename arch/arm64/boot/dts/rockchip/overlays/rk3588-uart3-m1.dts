/dts-v1/;
/plugin/;

/ {
	metadata {
		title = "Enable UART3-M1";
		compatible = "radxa,rock-5b", "radxa,rock-5b-plus", "radxa,rock-5t";
		category = "misc";
		exclusive = "GPIO3_B5", "GPIO3_B6";
		description = "Enable UART3-M1.
On Radxa ROCK 5B this is TX pin 12 and RX pin 35.
On Radxa ROCK 5B+ this is TX pin 12 and RX pin 35.
On Radxa ROCK 5T this is TX pin 12 and RX pin 35.";
	};
};

&uart3 {
	status = "okay";
	pinctrl-0 = <&uart3m1_xfer>;
};
