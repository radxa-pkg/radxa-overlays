/dts-v1/;
/plugin/;

/ {
	metadata {
		title = "Enable UART0";
		compatible = "radxa,rockpis", "radxa,rock-s0";
		category = "misc";
		exclusive = "GPIO2_A0", "GPIO2_A1", "spi0";
		description = "Enable UART0.
On ROCK PI S this is TX pin 8 & RX pin 10.
On ROCK S0 this is TX pin 8 & RX pin 10.";
	};
};

&uart0 {
	status = "okay";
	pinctrl-names = "default";
	pinctrl-0 = <&uart0_xfer>;
};

&spi0 {
	status = "disabled";
};
