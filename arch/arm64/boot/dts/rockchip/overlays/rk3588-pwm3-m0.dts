/dts-v1/;
/plugin/;

/ {
	metadata {
		title = "Enable PWM3-M0";
		compatible = "radxa,nx5-io";
		category = "misc";
		exclusive = "GPIO3_B2";
		description = "Enable PWM3-M0.
On Radxa NX5 IO this is pin 3.";
	};
};

&pwm3 {
	status = "okay";
	pinctrl-0 = <&pwm3m0_pins>;
};
