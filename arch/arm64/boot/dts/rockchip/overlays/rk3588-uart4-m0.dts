/dts-v1/;
/plugin/;

/ {
	metadata {
		title = "Enable UART4-M0";
		compatible = "radxa,nx5-io";
		category = "misc";
		exclusive= "GPIO1_D2", "GPIO1_D3";
		description = "Enable UART4-M0.
On Radxa NX5 IO this is TX pin 13 & RX pin 18.";
	};
};

&uart4 {
	status = "okay";
	pinctrl-0 = <&uart4m0_xfer>;
};
