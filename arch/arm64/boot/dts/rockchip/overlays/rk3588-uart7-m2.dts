/dts-v1/;
/plugin/;

/ {
	metadata {
		title = "Enable UART7-M2";
		compatible = "radxa,rock-5a", "radxa,rock-5b","radxa,rock-5b-plus", "radxa,rock-5c", "radxa,rock-5d", "radxa,rock-5t", "radxa,nx5-io", "radxa,cm5-rpi-cm4-io";
		category = "misc";
		exclusive= "GPIO1_B5", "GPIO1_B4";
		description = "Enable UART7-M2.
On Radxa ROCK 5A this is TX pin 22 and RX pin 33.
On Radxa ROCK 5B this is TX pin 26 & RX pin 24.
On Radxa ROCK 5B PLUS this is TX pin 26 & RX pin 24.
On Radxa ROCK 5C this is TX pin 22 and RX pin 33.
On Radxa ROCK 5D this is TX pin 22 and RX pin 33.
On Radxa ROCK 5T this is TX pin 26 & RX pin 24.
On Radxa NX5 IO this is TX pin 26 & RX pin 24.
On Radxa CM5 RPI CM4 IO this is TX pin 26 & RX pin 24.
";
	};
};

&uart7 {
	status = "okay";
	pinctrl-0 = <&uart7m2_xfer>;
};
