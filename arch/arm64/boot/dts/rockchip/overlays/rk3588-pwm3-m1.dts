/dts-v1/;
/plugin/;

/ {
	metadata {
		title = "Enable PWM3-M1";
		compatible = "radxa,rock-5b", "radxa,rock-5b-plus", "radxa,rock-5t";
		category = "misc";
		exclusive = "GPIO3_B2";
		description = "Enable PWM3-M1.
On Radxa ROCK 5B this is pin 38
On Radxa ROCK 5B+ this is pin 38.
On Radxa ROCK 5T this is pin 38.";
	};
};

&pwm3 {
	status = "okay";
	pinctrl-0 = <&pwm3m1_pins>;
};
