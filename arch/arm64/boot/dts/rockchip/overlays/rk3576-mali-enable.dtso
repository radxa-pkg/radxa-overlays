/dts-v1/;
/plugin/;

/ {
	metadata {
		title = "Enable Arm Mali GPU driver";
		compatible = "rockchip,rk3576";
		category = "misc";
		exclusive = "gpu", "gpu_mali";
		description = "Enable Arm Mali GPU driver.
This will disable opensource Panthor driver";
	};
};

&gpu {
	status = "disabled";
};

&gpu_mali {
	status = "okay";
	mali-supply = <&vdd_gpu_s0>;
};
