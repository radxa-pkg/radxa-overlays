/dts-v1/;
/plugin/;

/ {
	metadata {
		title = "Enable PWM5";
		compatible = "radxa,rock-s0";
		category = "misc";
		exclusive = "GPIO0_C1", "uart3";
		description = "Enable PWM5.
On ROCK S0 this is pin 15.";
	};
};

&pwm5 {
	status = "okay";
	pinctrl-names = "default";
	pinctrl-0 = <&pwm5_pin>;
};

&uart3 {
	status = "disabled";
};
