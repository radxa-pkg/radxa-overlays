/dts-v1/;
/plugin/;

/ {
	metadata {
		title = "Enable PWM0-M1";
		compatible = "radxa,nx5-io", "radxa,cm5-io";
		category = "misc";
		exclusive = "GPIO1_D2";
		description = "Enable PWM0-M1.
On Radxa NX5 IO this is pin 13.
On Radxa CM5 IO this is pin 38.";
	};
};

&pwm0 {
	status = "okay";
	pinctrl-0 = <&pwm0m1_pins>;
};
