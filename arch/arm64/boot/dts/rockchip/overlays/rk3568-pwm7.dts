/dts-v1/;
/plugin/;

/ {
	metadata {
		title = "Enable PWM7";
		compatible = "radxa,radxa-cm3-io", "radxa,radxa-cm3-sodimm-io", "radxa,e23", "radxa,e25";
		category = "misc";
		exclusive = "GPIO0_C6";
		description = "Enable PWM7.\nOn Radxa CM3 IO this is on pin 33.\nOn Radxa CM3 SODIMM IO this is on pin 22.\nOn Radxa E23 this is on pin 15.\nOn Radxa E25 this is on pin 18.";
	};

	fragment@0 {
		target = <&pwm7>;

		__overlay__ {
			status = "okay";
			pinctrl-names = "active";
			pinctrl-0 = <&pwm7_pins>;
		};
	};
};
