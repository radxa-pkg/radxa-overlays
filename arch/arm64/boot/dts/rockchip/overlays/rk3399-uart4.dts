/dts-v1/;
/plugin/;

/ {
	metadata {
		title = "Enable UART4";
		compatible = "rockchip,rk3399";
		category = "misc";
		exclusive = "GPIO1_B0", "GPIO1_A7";
		description = "Enable UART4.";
	};

	fragment@0 {
		target = <&uart4>;

		__overlay__ {
			status = "okay";
			pinctrl-names = "default";
			pinctrl-0 = <&uart4_xfer>;
		};
	};
};
