/dts-v1/;
/plugin/;

/ {
	metadata {
		title = "Enable SATA2";
		compatible = "radxa,rock-3b";
		category = "misc";
		exclusive = "em05_modem";
		description = "Enable SATA2.";
	};

	fragment@0 {
		target = <&sata2>;

		__overlay__ {
			status = "okay";
		};
	};
};