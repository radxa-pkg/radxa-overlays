/dts-v1/;
/plugin/;

/ {
	metadata {
		title = "Enable UART2-M1";
		compatible = "unknown";
		category = "misc";
		exclusive = "GPIO2_A0", "GPIO2_A1";
		description = "Enable UART2-M1";
	};
};

&uart2 {
	status = "okay";
	pinctrl-names = "default";
	pinctrl-0 = <&uart2m1_xfer>;
};
