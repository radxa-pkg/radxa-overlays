/dts-v1/;
/plugin/;
#include <dt-bindings/gpio/gpio.h>
#include <dt-bindings/pinctrl/rockchip.h>

/ {
		metadata {
				title = "Enable I2C6";
				compatible = "rockchip,rk3399";
				category = "misc";
				description = "Enable I2C6";
		};

		fragment@0 {
				target = <&i2c6>;

				__overlay__ {
						status = "okay";
						pinctrl-names = "default";
						pinctrl-0 = <&i2c2_xfer>;
				};
		};
};
