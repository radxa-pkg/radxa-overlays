/dts-v1/;
/plugin/;

/ {
	metadata {
		title = "Enable UART1-M0";
		compatible = "radxa,medge-rk3528a-io";
		category = "misc";
		exclusive = "GPIO4_A7", "GPIO4_A6";
		description = "Enable UART1-M0.
On Radxa mEdge-RK3528A IO this is TX pin 7 & RX pin 32.		
";
	};
};

&uart1 {
	status = "okay";
	pinctrl-names = "default";
	pinctrl-0 = <&uart1m0_xfer>;
};
