/dts-v1/;
/plugin/;

/ {
	metadata {
		title = "Enable UART3-M1";
		compatible = "radxa,rock-2a";
		category = "misc";
		exclusive = "GPIO4_B7", "GPIO4_C0";
		description = "Enable UART3-M1.
On Radxa ROCK 2A this is RX pin 11 & TX pin 13.";
	};
};

&uart3 {
	status = "okay";
	pinctrl-names = "default";
	pinctrl-0 = <&uart3m1_xfer>;
};
