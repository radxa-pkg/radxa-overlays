/dts-v1/;
/plugin/;

/ {
	metadata {
		title = "Enable UART3";
		compatible = "radxa,rockpis";
		category = "misc";
		exclusive = "GPOI3_B4", "GPOI3_B5";
		description = "Enable UART3.
On Radxa ROCK S v1.3 this RX pin 40 & TX pin 39.";
	};
};

&uart3 {
	status = "okay";
	pinctrl-names = "default";
	pinctrl-0 = <&uart3_xfer>;
};
