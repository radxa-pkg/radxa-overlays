/dts-v1/;
/plugin/;

/ {
	metadata {
		title = "Enable PWM2-M1";
		compatible = "radxa,rock-5b", "radxa,rock-5b-plus", "radxa,rock-5t";
		category = "misc";
		exclusive = "GPIO3_B1";
		description = "Enable PWM2-M1.
On Radxa ROCK 5B this is pin 36
On Radxa ROCK 5B+ this is pin 36.
On Radxa ROCK 5T this is pin 36.";
	};
};

&pwm2 {
	status = "okay";
	pinctrl-0 = <&pwm2m1_pins>;
};
