#include "radxa-nx4-c200-radxa-camera-8m-219-on-cam1.dts"

/ {
	metadata {
		title ="Enable Raspberry Pi Camera V2 on CAM1";
		description = "Enable Raspberry Pi Camera V2 on CAM1.";
	};
};

&imx219 {
	rockchip,camera-module-name = "rpi-camera-v2";
};
