/dts-v1/;
/plugin/;

/ {
	metadata {
		title = "Set OTG port to Host mode";
		compatible = "rockchip,rk3399";
		category = "misc";
		exclusive = "usbdrd_dwc3_0-dr_mode";
		description = "Set OTG port to Host mode.
Use this when you want to connect USB devices.";
	};
};

&usbdrd_dwc3_0 {
	status = "okay";
	dr_mode = "host";
};
