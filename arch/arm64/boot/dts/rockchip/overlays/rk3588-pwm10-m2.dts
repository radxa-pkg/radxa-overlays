/dts-v1/;
/plugin/;

/ {
	metadata {
		title = "Enable PWM10-M2";
		compatible = "radxa,cm5-io", "radxa,nx5-io";
		category = "misc";
		exclusive = "GPIO3_D3";
		description = "Enable PWM10-M2.\nOn Radxa CM5 IO this is pin 3\nOn Radxa NX5 IO this is pin 36.";
	};
};

&pwm10 {
	status = "okay";
	pinctrl-0 = <&pwm10m2_pins>;
};
