/dts-v1/;
/plugin/;

#include "rock-3-ov5647.dtsi"

/ {
	metadata {
		title = "Enable OKdo 5MP Camera";
		compatible = "radxa,rock-3a", "radxa,rock-3b";
		category = "camera";
		description = "Enable OKdo 5MP Camera.";
	};
};
