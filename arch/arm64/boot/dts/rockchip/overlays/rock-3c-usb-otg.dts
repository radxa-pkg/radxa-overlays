// ROCK 3C USB OTG
/dts-v1/;
/plugin/;

/ {
	metadata {
		title ="Set OTG port to OTG mode";
		compatible = "radxa,rock-3c";
		category = "misc";
		description = "Set OTG port to OTG mode.";
	};

	fragment@0 {
		target = <&usbdrd_dwc3>;

		__overlay__ {
			dr_mode = "otg";
		};
	};
};
