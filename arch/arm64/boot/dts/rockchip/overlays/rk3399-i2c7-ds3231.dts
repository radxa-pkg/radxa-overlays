/dts-v1/;
/plugin/;

/ {
	metadata {
		title = "Enable DS3231 RTC on I2C7";
		compatible = "rockchip,rk3399";
		category = "misc";
		exclusive = "GPIO2_A7", "GPIO2_B0";
		description = "Enable DS3231 RTC on I2C7.";
	};
};

&i2c7 {
	status = "okay";
	pinctrl-names = "default";
	pinctrl-0 = <&i2c7_xfer>;
	#address-cells = <1>;
	#size-cells = <0>;

	ds3231: ds3231@68 {
		compatible = "maxim,ds3231";
		reg = <0x68>;
		#clock-cells = <1>;
	};
};
