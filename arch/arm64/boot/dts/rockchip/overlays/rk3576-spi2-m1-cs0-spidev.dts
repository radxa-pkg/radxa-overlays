/dts-v1/;
/plugin/;

/ {
	metadata {
		title = "Enable spidev on SPI2-M1 over CS0";
		compatible = "radxa,cm4-rpi-cm4-io";
		category = "misc";
		exclusive = "GPIO1_C3", "GPIO1_D5", "GPIO1_C4", "GPIO1_C5", "spi2";
		description = "Enable spidev on SPI2-M1 over CS0.";
	};
};

&spi2 {
	status = "okay";
	#address-cells = <1>;
	#size-cells = <0>;
	pinctrl-names = "default";
	pinctrl-0 = <&spi2m1_csn0 &spi2m1_pins>;
	max-freq = <50000000>;

	spidev@0 {
		compatible = "rockchip,spidev";
		status = "okay";
		reg = <0>;
		spi-max-frequency = <50000000>;
	};
};
