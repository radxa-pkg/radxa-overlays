/dts-v1/;
/plugin/;

/ {
	metadata {
		title = "Enable FIQ Debugger on UART8-M0";
		compatible = "radxa,rock-5a", "radxa,rock-5c", "radxa,rock-5d";
		category = "misc";
		exclusive = "GPIO4_B0", "GPIO4_B1";
		description = "Enable FIQ Debugger on UART8-M0.
On Radxa ROCK 5A this is TX pin 32 and RX pin 40.
On Radxa ROCK 5C this is TX pin 32 and RX pin 40.
";
	};
};

&fiq_debugger {
	status = "okay";
	rockchip,serial-id = <8>;
	pinctrl-names = "default";
	pinctrl-0 = <&uart8m0_xfer>;
};

&uart8 {
	status = "disabled";
};
