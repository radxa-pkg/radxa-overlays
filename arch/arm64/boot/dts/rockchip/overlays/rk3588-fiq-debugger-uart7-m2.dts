/dts-v1/;
/plugin/;

/ {
	metadata {
		title = "Enable FIQ Debugger on UART7-M2";
		compatible = "radxa,rock-5b";
		category = "misc";
		exclusive = "GPIO1_B4", "GPIO1_B5";
		description = "Enable FIQ Debugger on UART7-M2.\nOn Radxa ROCK 5B this is TX pin 26 , RX pin 24.";
	};

	fragment@0 {
		target = <&fiq_debugger>;

		__overlay__ {
			status = "okay";
			rockchip,serial-id = <7>;
			pinctrl-names = "default";
			pinctrl-0 = <&uart7m2_xfer>;
		};
	};

	fragment@1 {
		target = <&uart7>;

		__overlay__ {
			status = "disabled";
		};
	};
};
