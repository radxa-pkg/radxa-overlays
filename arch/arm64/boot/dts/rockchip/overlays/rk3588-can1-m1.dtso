/dts-v1/;
/plugin/;

#include <dt-bindings/clock/rk3588-cru.h>

/ {
	metadata {
		title = "Enable CAN1-M1";
		compatible = "radxa,rock-5a", "radxa,rock-5b", "radxa,rock-5b-plus", "radxa,rock-5c", "radxa,rock-5d";
		category = "misc";
		exclusive = "GPIO4_B2", "GPIO4_B3";
		description = "Enable CAN1-M0.
On Radxa ROCK 5A this is RX pin 13 & TX pin 11.
On Radxa ROCK 5B this is RX pin 5 & TX pin 3.
On Radxa ROCK 5C this is RX pin 13 & TX pin 11.
On Radxa ROCK 5D this is RX pin 13 & TX pin 11.
";
	};
};

&can1 {
	compatible = "rockchip,can-2.0";
	status = "okay";
	assigned-clocks = <&cru CLK_CAN1>;
	assigned-clock-rates = <200000000>;
	pinctrl-names = "default";
	pinctrl-0 = <&can1m1_pins>;
};
