/dts-v1/;
/plugin/;

/ {
	metadata {
		title = "Enable PWM14-M1";
		compatible = "radxa,rock-3c", "radxa,rock-3b";
		category = "misc";
		exclusive = "GPIO4_C2", "pwm14";
		description = "Enable PWM14-M1.\nOn Radxa ROCK 3B this is pin 23.\nOn Radxa ROCK 3C this is pin 23.";
	};

	fragment@0 {
		target = <&pwm14>;

		__overlay__ {
			status = "okay";
			pinctrl-names = "active";
			pinctrl-0 = <&pwm14m1_pins>;
		};
	};
};
