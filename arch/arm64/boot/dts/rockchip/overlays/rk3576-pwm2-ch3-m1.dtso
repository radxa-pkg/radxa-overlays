/dts-v1/;
/plugin/;

/ {
	metadata {
		title = "Enable PWM2-CH3-M1";
		compatible = "unknown";
		category = "misc";
		exclusive = "GPIO4_C7", "pwm2_8ch_3";
		description = "Enable PWM2-CH3-M1.";
	};
};

&pwm2_8ch_3 {
	status = "okay";
	pinctrl-0 = <&pwm2m1_ch3>;
};
