/dts-v1/;
/plugin/;

/ {
	metadata {
		title = "Enable PWM1-CH0-M1";
		compatible = "radxa,cm4-rpi-cm4-io";
		category = "misc";
		exclusive = "GPIO1_B4", "pwm1_6ch_0";
		description = "Enable PWM1-CH0-M1.
On Radxa CM4-RPI-CM4-IO this is pin 23.";
	};
};

&pwm1_6ch_0 {
	status = "okay";
	pinctrl-0 = <&pwm1m1_ch0>;
};
