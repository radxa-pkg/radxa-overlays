/dts-v1/;
/plugin/;

/ {
	metadata {
		title = "Enable PWM11-M0";
		compatible = "radxa,cm3j-rpi-cm4-io";
		category = "misc";
		exclusive = "GPIO3_B6", "pwm11";
		description = "Enable PWM11-M0.
On Radxa CM3J RPI CM4 IO this is pin 3.
";
	};
};

&pwm11 {
	status = "okay";
	pinctrl-names = "active";
	pinctrl-0 = <&pwm11m0_pins>;
};
