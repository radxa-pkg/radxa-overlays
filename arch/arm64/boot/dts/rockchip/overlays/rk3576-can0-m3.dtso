/dts-v1/;
/plugin/;

#include <dt-bindings/clock/rockchip,rk3576-cru.h>

/ {
	metadata {
		title = "Enable CAN0-M3";
		compatible = "radxa,nx4-c200";
		category = "misc";
		exclusive = "GPIO3_C1", "GPIO3_C4", "can0";
		description = "Enable CAN0-M3.";
	};
};

&can0 {
	assigned-clocks = <&cru CLK_CAN1>;
	assigned-clock-rates = <200000000>;
	pinctrl-names = "default";
	pinctrl-0 = <&can0m3_pins>;
	status = "okay";
};
