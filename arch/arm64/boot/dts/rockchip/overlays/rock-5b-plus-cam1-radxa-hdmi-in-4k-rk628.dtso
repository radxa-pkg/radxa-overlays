/dts-v1/;
/plugin/;

#define RK628_CAM1_I2C i2c4
#include "rk3588-radxa-hdmi-in-4k-rk628-cam1.dtsi"

/ {
	metadata {
		compatible = "radxa,rock-5b-plus", "radxa,rock-5t";
	};
};

&i2c4 {
	pinctrl-names = "default";
	pinctrl-0 = <&i2c4m1_xfer>;
};
