/dts-v1/;
/plugin/;

#include <dt-bindings/gpio/gpio.h>
#include <dt-bindings/pinctrl/rockchip.h>

/ {
	metadata {
		title = "Enable 1-Wire on GPIO1_D0";
		compatible = "radxa,cm4-rpi-cm4-io";
		category = "misc";
		exclusive = "GPIO1_D0";
		description = "Enable 1-Wire on GPIO1_D0.
On Radxa CM4 RPI CM4 IO this is pin 40.
";
	};
};

&{/} {
	w1: onewire {
		compatible = "w1-gpio";
		gpios = <&gpio1 RK_PD0 GPIO_ACTIVE_HIGH>;
		status = "okay";
	};
};
