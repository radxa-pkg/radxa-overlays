#include "rk3588-spi4-m2-cs0-waveshare35.dts"

/ {
	metadata {
		title = "Enable Waveshare 3.5inch RPi LCD (B) on SPI4";
		description = "Enable Waveshare 3.5inch RPi LCD (B) on SPI4.";
	};
};

&ili9486 {
	init = <0x10000b0 0x0
			0x1000011
			0x20000ff
			0x1000021
			0x100003a 0x55
			0x10000c2 0x33
			0x10000c5 0x0 0x1e 0x80
			0x1000036 0x28
			0x10000b1 0xb0
			0x10000e0 0x0 0x13 0x18 0x4 0xf 0x6 0x3a 0x56 0x4d 0x3 0xa 0x6 0x30 0x3e 0xf
			0x10000e1 0x0 0x13 0x18 0x1 0x11 0x6 0x38 0x34 0x4d 0x6 0xd 0xb 0x31 0x37 0xf
			0x1000011
			0x20000ff
			0x1000029>;
};
