/dts-v1/;
/plugin/;

/ {
	metadata {
		title = "Enable UART9-M1";
		compatible = "radxa,rock-3c", "radxa,rock-3b";
		category = "misc";
		exclusive = "GPIO4_C5", "GPIO4_C6";
		description = "Enable UART9-M1.\nOn Radxa ROCK 3B this is TX pin 21 and this is RX pin 24.";
	};

	fragment@0 {
		target = <&uart9>;

		__overlay__ {
			status = "okay";
			pinctrl-names = "default";
			pinctrl-0 = <&uart9m1_xfer>;
		};
	};
};
