/dts-v1/;
/plugin/;

/ {
	metadata {
		title = "Enable UART0";
		compatible = "unknown";
		category = "misc";
		description = "Enable UART0.";
	};
};

&uart0 {
	status = "okay";
	pinctrl-names = "default";
	pinctrl-0 = <&uart0_xfer &uart0_cts &uart0_rts>;
};
